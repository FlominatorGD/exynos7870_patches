## drivers/thermal/Kconfig.patch
```kconfig
diff --git a/drivers/thermal/Kconfig b/drivers/thermal/Kconfig
index f554d25b4399..2b515b4c946a 100644
--- a/drivers/thermal/Kconfig
+++ b/drivers/thermal/Kconfig
@@ -112,6 +112,30 @@ config CPU_THERMAL
 
 	  If you want this support, you should say Y here.
 
+config GPU_THERMAL
+	bool "generic gpu cooling support"
+	depends on THERMAL_OF
+	help
+	  This implements the generic gpu cooling mechanism through frequency
+	  reduction. An ACPI version of this already exists
+	  (drivers/acpi/processor_thermal.c).
+	  This will be useful for platforms using the generic thermal interface
+	  and not the ACPI interface.
+
+	  If you want this support, you should say Y here.
+
+config ISP_THERMAL
+	bool "generic isp cooling support"
+	depends on THERMAL_OF
+	help
+	  This implements the generic gpu cooling mechanism through frequency
+	  reduction. An ACPI version of this already exists
+	  (drivers/acpi/processor_thermal.c).
+	  This will be useful for platforms using the generic thermal interface
+	  and not the ACPI interface.
+
+	  If you want this support, you should say Y here.
+
 config THERMAL_EMULATION
 	bool "Thermal emulation mode support"
 	help
@@ -159,6 +183,20 @@ config KIRKWOOD_THERMAL
 	  Support for the Kirkwood thermal sensor driver into the Linux thermal
 	  framework. Only kirkwood 88F6282 and 88F6283 have this sensor.
 
+config EXYNOS_THERMAL
+	tristate "Temperature sensor on Samsung EXYNOS"
+	depends on (ARCH_EXYNOS4 || ARCH_EXYNOS5 || ARCH_EXYNOS7 || ARCH_EXYNOS8)
+	depends on CPU_THERMAL
+	help
+	  If you say yes here you get support for TMU (Thermal Management
+	  Unit) on SAMSUNG EXYNOS series of SoC.
+
+config EXYNOS_SWTRIP
+	bool "SW TRIP Feature on Samsung EXYNOS"
+	depends on EXYNOS_THERMAL
+	help
+	  Support for SWTRIP uevent on SAMSUNG EXYNOS series of SOC
+
 config DOVE_THERMAL
 	tristate "Temperature sensor on Marvell Dove SoCs"
 	depends on ARCH_DOVE || MACH_DOVE
@@ -253,6 +291,30 @@ config ACPI_THERMAL_REL
 	tristate
 	depends on ACPI
 
+config CPU_THERMAL_IPA
+	bool "Enable Intelligent Power Arbiter"
+	depends on THERMAL && CPU_FREQ && EXYNOS_THERMAL
+	help
+	  This implements the Intelligent Power Arbiter (IPA)
+
+config CPU_THERMAL_IPA_CONTROL
+	bool "Enable control"
+	depends on CPU_THERMAL_IPA
+	help
+	  This implements the intelligent power arbiter (IPA) control algorithms.
+	  If you want this support, you should say Y here.
+
+config CPU_THERMAL_IPA_DEBUG
+	bool "Enable debugging"
+	depends on CPU_THERMAL_IPA
+	select FUNCTION_TRACER
+	select DYNAMIC_FTRACE
+	help
+	  This enables *trace* routines in IPA, used to collect logs
+	  of temperature, CPU and GPU utilisations and power
+	  estimates.  If you want to analyze IPA behaviour, you should
+	  say Y here.
+
 menu "Texas Instruments thermal drivers"
 source "drivers/thermal/ti-soc-thermal/Kconfig"
 endmenu
@@ -268,3 +330,8 @@ source "drivers/thermal/st/Kconfig"
 endmenu
 
 endif
+
+menu "Samsung thermal drivers"
+depends on ARCH_EXYNOS
+source "drivers/thermal/samsung/Kconfig"
+endmenu
```

## drivers/thermal/samsung/Kconfig.patch
```kconfig
diff --git a/drivers/thermal/samsung/Kconfig b/drivers/thermal/samsung/Kconfig
index f760389a204c..bc260086c979 100644
--- a/drivers/thermal/samsung/Kconfig
+++ b/drivers/thermal/samsung/Kconfig
@@ -1,6 +1,7 @@
 config EXYNOS_THERMAL
 	tristate "Exynos thermal management unit driver"
 	depends on ARCH_HAS_BANDGAP && OF
+	depends on CPU_THERMAL
 	help
 	  If you say yes here you get support for the TMU (Thermal Management
 	  Unit) driver for SAMSUNG EXYNOS series of SoCs. This driver initialises
```

## drivers/tty/serial/Kconfig.patch
```kconfig
diff --git a/drivers/tty/serial/Kconfig b/drivers/tty/serial/Kconfig
index 649b784081c7..d2293e62df5c 100644
--- a/drivers/tty/serial/Kconfig
+++ b/drivers/tty/serial/Kconfig
@@ -256,13 +256,13 @@ config SERIAL_SAMSUNG_UARTS_4
 
 config SERIAL_SAMSUNG_UARTS
 	int
-	depends on PLAT_SAMSUNG
+	depends on PLAT_SAMSUNG || ARCH_EXYNOS
 	default 4 if SERIAL_SAMSUNG_UARTS_4 || CPU_S3C2416
-	default 3
+	default 10
 	help
 	  Select the number of available UART ports for the Samsung S3C
 	  serial driver
-	
+
 config SERIAL_SAMSUNG_DEBUG
 	bool "Samsung SoC serial debug"
 	depends on SERIAL_SAMSUNG && DEBUG_LL
@@ -276,6 +276,7 @@ config SERIAL_SAMSUNG_CONSOLE
 	bool "Support for console on Samsung SoC serial port"
 	depends on SERIAL_SAMSUNG=y
 	select SERIAL_CORE_CONSOLE
+	select SERIAL_EARLYCON
 	help
 	  Allow selection of the S3C24XX on-board serial ports for use as
 	  an virtual console.
@@ -287,6 +288,15 @@ config SERIAL_SAMSUNG_CONSOLE
 	  your boot loader about how to pass options to the kernel at
 	  boot time.)
 
+config S3C_LOWLEVEL_UART_PORT
+	int "S3C UART to use for low-level messages"
+	default 0
+	help
+	  Choice of which UART port to use for the low-level messages,
+	  such as the `Uncompressing...` at start time. The value of
+	  this configuration should be between zero and five. The port
+	  must have been initialised by the boot-loader before use.
+
 config SERIAL_SIRFSOC
         tristate "SiRF SoC Platform Serial port support"
         depends on ARCH_SIRF
```

## drivers/usb/Kconfig.patch
```kconfig
diff --git a/drivers/usb/Kconfig b/drivers/usb/Kconfig
index ae481c37a208..9331d0372db6 100644
--- a/drivers/usb/Kconfig
+++ b/drivers/usb/Kconfig
@@ -98,6 +98,10 @@ endif
 
 source "drivers/usb/musb/Kconfig"
 
+source "drivers/usb/notify/Kconfig"
+
+source "drivers/usb/manager/Kconfig"
+
 source "drivers/usb/dwc3/Kconfig"
 
 source "drivers/usb/dwc2/Kconfig"
@@ -149,6 +153,8 @@ source "drivers/usb/phy/Kconfig"
 
 source "drivers/usb/gadget/Kconfig"
 
+source "drivers/usb/typec/Kconfig"
+
 config USB_LED_TRIG
 	bool "USB LED Triggers"
 	depends on LEDS_CLASS && USB_COMMON && LEDS_TRIGGERS
```

## drivers/usb/core/Kconfig.patch
```kconfig
diff --git a/drivers/usb/core/Kconfig b/drivers/usb/core/Kconfig
index 9cfda6a72194..bd880c83a9cf 100644
--- a/drivers/usb/core/Kconfig
+++ b/drivers/usb/core/Kconfig
@@ -66,6 +66,17 @@ config USB_OTG_WHITELIST
 	  "Targeted Peripherals List".  "Embedded Hosts" are likewise
 	  allowed to support only a limited number of peripherals.
 
+config USB_OTG_WHITELIST_FOR_MDM
+	bool "Rely on OTG and EH Targeted Peripherals List"
+	depends on USB
+	help
+	  If you say Y here, the "otg_whitelist.h" file will be used as a
+	  product whitelist, so USB peripherals not listed there will be
+	  rejected during enumeration.  This behavior is required by the
+	  USB OTG and EH specification for all devices not on your product's
+	  "Targeted Peripherals List".  "Embedded Hosts" are likewise
+	  allowed to support only a limited number of peripherals.
+
 config USB_OTG_BLACKLIST_HUB
 	bool "Disable external hubs"
 	depends on USB_OTG || EXPERT
@@ -84,3 +95,21 @@ config USB_OTG_FSM
 	  Implements OTG Finite State Machine as specified in On-The-Go
 	  and Embedded Host Supplement to the USB Revision 2.0 Specification.
 
+config HOST_COMPLIANT_TEST
+	bool "Embedded High-speed Host Electrical Test Support"
+	depends on USB && USB_ARCH_HAS_HCD
+	default n
+	help
+	  This option is only used if you are developing firmware for
+	  an embedded device with a Hi-speed USB Host or OTG port.
+
+	  If you say Y here, software support for the Embedded
+	  High-speed Host Electrical Tests will be added to the USB
+	  Host stack. This is one of the tests performed during
+	  High-speed USB Host certification testing.
+
+	  Please note that the USB Host Controller Driver must also
+	  support this option. For an example of how to add support
+	  for this to a USB Host Controller Driver see the EHCI driver.
+
+	  If you are at all unsure then say N here.
```

## drivers/usb/gadget/Kconfig.patch
```kconfig
diff --git a/drivers/usb/gadget/Kconfig b/drivers/usb/gadget/Kconfig
index 401ef20ea648..a55f2c8f3591 100644
--- a/drivers/usb/gadget/Kconfig
+++ b/drivers/usb/gadget/Kconfig
@@ -377,6 +377,20 @@ config USB_CONFIGFS_F_FS
 	  implemented in kernel space (for instance Ethernet, serial or
 	  mass storage) and other are implemented in user space.
 
+config USB_CONFIGFS_F_DM
+        boolean "DM gadget"
+        depends on USB_CONFIGFS
+        select USB_F_DM
+        help
+          USB gadget DM(Diagnosis Monitor) support
+
+config USB_CONFIGFS_F_ADB
+	boolean "ADB gadget"
+	depends on USB_CONFIGFS
+	select USB_F_ADB
+	help
+	  USB gadget ADB support
+
 config USB_CONFIGFS_F_MTP
         boolean "MTP gadget"
         depends on USB_CONFIGFS
@@ -439,6 +453,70 @@ config USB_G_ANDROID
 	  Each function can be configured and enabled/disabled
 	  dynamically from userspace through a sysfs interface.
 
+config USB_ANDROID_SAMSUNG_COMPOSITE
+	boolean "Samsung Composite function"
+	depends on USB_G_ANDROID
+	help
+	  Provides SAMSUNG composite driver.
+	  Multi Configuration.
+	  If you enable this option, android composite will be changed.
+
+config USB_ANDROID_SAMSUNG_MTP
+	boolean "Samsung MTP function"
+	depends on USB_G_ANDROID && !SEC_FACTORY
+	help
+	  Provides Media Transfer Protocol (MTP) support
+	  for samsung gadget driver.
+	  If you enable this option,
+	  google mtp will be changed to samsung mtp.
+
+config USB_F_CONN_GADGET_NDOP
+    bool "Conn gadget that do not support DexLive"
+	depends on USB_G_ANDROID
+	depends on ANDROID_MAJOR_VERSION >= "q"
+	help
+	  Next SideSync
+
+config USB_LOCK_SUPPORT_FOR_MDM
+	boolean "Samsung USB_LOCK function for MDM"
+	depends on USB_G_ANDROID
+	help
+	  Support USB lock for SDS MDM function.
+	  If you enable this option,
+	  USB is not connected to the work in office.
+	  Of employees who have installed MDM(SDS).
+
+config USB_DUN_SUPPORT
+	boolean "DUN support function"
+	depends on USB_G_ANDROID
+	help
+	  Provides USB modem serial driver.
+	  This function makes connection to acm from data router.
+	  It uses misc register.
+	  Support fops : open, close, release, read, poll, llseek, ioctl
+
+config USB_NCM_SUPPORT_MTU_CHANGE
+	boolean "Samsung NCM MTU Change function"
+	depends on USB_G_ANDROID
+	help
+	   Provides NCM MTU Change support
+	   for samsung gadget driver.
+	   If you enable this option,
+	   NCM MTU Change will be able to be used.
+	  
+
+config USB_RNDIS_MULTIPACKET
+	boolean "Samsung Rndis Multi Packet support"
+	depends on USB_G_ANDROID
+	help
+		Rndis Multipacket Support.
+		
+config USB_ANDROID_SAMSUNG_CCR_PROTOCOL
+	boolean "Samsung USB CCR Protocol support"
+	depends on USB_G_ANDROID
+	help
+		CCR Protocol Support.
+
 config USB_ANDROID_RNDIS_DWORD_ALIGNED
 	boolean "Use double word aligned"
 	depends on USB_G_ANDROID
```

## drivers/usb/misc/Kconfig.patch
```kconfig
diff --git a/drivers/usb/misc/Kconfig b/drivers/usb/misc/Kconfig
index 34e2e29061c9..8edcd784eb0a 100644
--- a/drivers/usb/misc/Kconfig
+++ b/drivers/usb/misc/Kconfig
@@ -46,6 +46,16 @@ config USB_SEVSEG
 	  To compile this driver as a module, choose M here: the
 	  module will be called usbsevseg.
 
+config USB_RIO500
+	tristate "USB Diamond Rio500 support"
+	help
+	  Say Y here if you want to connect a USB Rio500 mp3 player to your
+	  computer's USB port. Please read <file:Documentation/usb/rio.txt>
+	  for more information.
+
+	  To compile this driver as a module, choose M here: the
+	  module will be called rio500.
+
 config USB_LEGOTOWER
 	tristate "USB Lego Infrared Tower support"
 	help
@@ -190,7 +200,9 @@ config USB_TEST
 	  including sample test device firmware and "how to use it".
 
 config USB_EHSET_TEST_FIXTURE
-        tristate "USB EHSET Test Fixture driver"
+        bool "USB EHSET Test Fixture driver"
+	depends on HOST_COMPLIANT_TEST
+	default y
         help
 	  Say Y here if you want to support the special test fixture device
 	  used for the USB-IF Embedded Host High-Speed Electrical Test procedure.
```

## drivers/usb/phy/Kconfig.patch
```kconfig
diff --git a/drivers/usb/phy/Kconfig b/drivers/usb/phy/Kconfig
index 77ef4bb73d41..937786580fd2 100644
--- a/drivers/usb/phy/Kconfig
+++ b/drivers/usb/phy/Kconfig
@@ -86,6 +86,15 @@ config SAMSUNG_USBPHY
 	  This driver provides common interface to interact, for Samsung USB 2.0 PHY
 	  driver and later for Samsung USB 3.0 PHY driver.
 
+config DUAL_ROLE_USB_INTF
+	bool "Generic DUAL ROLE sysfs interface"
+	depends on !TYPEC
+	help
+	  A generic sysfs interface to track and change the state of
+	  dual role usb phys. The usb phy drivers can register to
+	  this interface to expose it capabilities to the userspace
+	  and thereby allowing userspace to change the port mode.
+
 config TWL6030_USB
 	tristate "TWL6030 USB Transceiver Driver"
 	depends on TWL4030_CORE && OMAP_USB2 && USB_MUSB_OMAP2PLUS
```

## drivers/video/Kconfig.patch
```kconfig
diff --git a/drivers/video/Kconfig b/drivers/video/Kconfig
index 49fcbb1632af..1daa05544ed9 100644
--- a/drivers/video/Kconfig
+++ b/drivers/video/Kconfig
@@ -17,6 +17,8 @@ config SH_LCD_MIPI_DSI
 
 source "drivers/char/agp/Kconfig"
 
+source "drivers/gpu/arm/Kconfig"
+
 source "drivers/gpu/vga/Kconfig"
 
 source "drivers/gpu/host1x/Kconfig"
```

## fs/Kconfig.patch
```kconfig
diff --git a/fs/Kconfig b/fs/Kconfig
index 874e1c4c5906..21e4c9983a4c 100644
--- a/fs/Kconfig
+++ b/fs/Kconfig
@@ -8,11 +8,16 @@ menu "File systems"
 config DCACHE_WORD_ACCESS
        bool
 
+config INTERRUPTIBLE_SYNC
+	bool "Support interruptible sync for Samsung Mobile Device"
+	default y
+
 if BLOCK
 
 source "fs/ext2/Kconfig"
 source "fs/ext3/Kconfig"
 source "fs/ext4/Kconfig"
+source "fs/sdcardfs/Kconfig"
 
 config FS_XIP
 # execute in place
@@ -91,6 +96,7 @@ if BLOCK
 menu "DOS/FAT/NT Filesystems"
 
 source "fs/fat/Kconfig"
+source "fs/sdfat/Kconfig"
 source "fs/ntfs/Kconfig"
 
 endmenu
@@ -188,7 +194,6 @@ if MISC_FILESYSTEMS
 source "fs/adfs/Kconfig"
 source "fs/affs/Kconfig"
 source "fs/ecryptfs/Kconfig"
-source "fs/sdcardfs/Kconfig"
 source "fs/hfs/Kconfig"
 source "fs/hfsplus/Kconfig"
 source "fs/befs/Kconfig"
```

## fs/f2fs/Kconfig.patch
```kconfig
diff --git a/fs/f2fs/Kconfig b/fs/f2fs/Kconfig
index 378c221d68a9..02c0616c8181 100644
--- a/fs/f2fs/Kconfig
+++ b/fs/f2fs/Kconfig
@@ -68,12 +68,23 @@ config F2FS_FS_SECURITY
 
 config F2FS_CHECK_FS
 	bool "F2FS consistency checking feature"
-	depends on F2FS_FS
+	depends on F2FS_FS && SEC_FACTORY
+	default y
 	help
 	  Enables BUG_ONs which check the filesystem consistency in runtime.
 
 	  If you want to improve the performance, say N.
 
+config F2FS_STRICT_BUG_ON
+	bool "F2FS consistency checking feature"
+	depends on F2FS_FS
+	default y
+	help
+	  Use BUG_ON() instead of WARN_ON(), when there is an error 
+	  in the filesystem consistency.
+
+	  Default Y.
+
 config F2FS_FS_ENCRYPTION
 	bool "F2FS Encryption"
 	depends on F2FS_FS
```
