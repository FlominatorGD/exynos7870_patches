## init/Kconfig.patch
```kconfig
diff --git a/init/Kconfig b/init/Kconfig
index 203881d80b11..de2d6ce015bb 100644
--- a/init/Kconfig
+++ b/init/Kconfig
@@ -26,16 +26,6 @@ config IRQ_WORK
 config BUILDTIME_EXTABLE_SORT
 	bool
 
-config THREAD_INFO_IN_TASK
-	bool
-	help
-	  Select this to move thread_info off the stack into task_struct.  To
-	  make this work, an arch will need to remove all thread_info fields
-	  except flags and fix any runtime bugs.
-
-	  One subtle change that will be needed is to use try_get_task_stack()
-	  and put_task_stack() in save_thread_stack_tsk() and get_wchan().
-
 menu "General setup"
 
 config BROKEN
@@ -295,7 +285,6 @@ config FHANDLE
 
 config USELIB
 	bool "uselib syscall"
-	default y
 	help
 	  This option enables the uselib syscall, a system call used in the
 	  dynamic linker from libc5 and earlier.  glibc does not use this
@@ -818,6 +807,7 @@ config BUILD_BIN2C
 
 config IKCONFIG
 	tristate "Kernel .config support"
+	default y if ANDROID_MAJOR_VERSION = "o" || ANDROID_MAJOR_VERSION = "p" || ANDROID_MAJOR_VERSION = "q"
 	select BUILD_BIN2C
 	---help---
 	  This option enables the complete Linux kernel ".config" file
@@ -832,6 +822,7 @@ config IKCONFIG
 config IKCONFIG_PROC
 	bool "Enable access to .config through /proc/config.gz"
 	depends on IKCONFIG && PROC_FS
+	default y
 	---help---
 	  This option enables access to the kernel configuration file
 	  through /proc/config.gz.
@@ -1058,6 +1049,7 @@ config MEMCG_SWAP
 	  if boot option "swapaccount=0" is set, swap will not be accounted.
 	  Now, memory usage of swap_cgroup is 2 bytes per entry. If swap page
 	  size is 4096bytes, 512k per 1Gbytes of swap.
+
 config MEMCG_SWAP_ENABLED
 	bool "Memory Resource Controller Swap Extension enabled by default"
 	depends on MEMCG_SWAP
@@ -1071,6 +1063,12 @@ config MEMCG_SWAP_ENABLED
 	  For those who want to have the feature enabled by default should
 	  select this option (if, for some reason, they need to disable it
 	  then swapaccount=0 does the trick).
+
+config MEMCG_FORCE_USE_VM_SWAPPINESS
+	bool "Force to use vm_swappiness instead of memcg->swappiness"
+	depends on MEMCG_SWAP
+	default y
+
 config MEMCG_KMEM
 	bool "Memory Resource Controller Kernel Memory accounting"
 	depends on MEMCG
@@ -1088,7 +1086,11 @@ config MEMCG_KMEM
 	  are plenty of kmem available for reclaim. That makes this option
 	  unusable in real life so DO NOT SELECT IT unless for development
 	  purposes.
-
+config MEMCG_HIGHER_SWAPPINESS
+	int "Allow swappiness to be increased up to 200"
+	default 0
+	help
+	  Increase swappiness for all the memcg
 config CGROUP_HUGETLB
 	bool "HugeTLB Resource Controller for Control Groups"
 	depends on RESOURCE_COUNTERS && HUGETLB_PAGE
```

## kernel/Kconfig.freezer.patch
```kconfig
diff --git a/kernel/Kconfig.freezer b/kernel/Kconfig.freezer
index a3bb4cb52539..99d7cb13799a 100644
--- a/kernel/Kconfig.freezer
+++ b/kernel/Kconfig.freezer
@@ -1,2 +1,7 @@
 config FREEZER
 	def_bool PM_SLEEP || CGROUP_FREEZER
+config OLAF_SUPPORT
+	bool "thaw frozen process when recieve sig"
+	default n
+	help
+		thaw frozen process when recieve sig. enable if samsung olaf solution exist
\ No newline at end of file
```

## lib/Kconfig.debug.patch
```kconfig
diff --git a/lib/Kconfig.debug b/lib/Kconfig.debug
index 4f2d0945fa57..16151b02740c 100644
--- a/lib/Kconfig.debug
+++ b/lib/Kconfig.debug
@@ -15,6 +15,21 @@ config PRINTK_TIME
 	  The behavior is also controlled by the kernel command line
 	  parameter printk.time=1. See Documentation/kernel-parameters.txt
 
+config PRINTK_CORE_NUM
+	bool "Show core number on printks"
+	depends on PRINTK
+	help
+	  Selecting this option causes core number to be
+	  included in printk output. Or add printk.core_num=1 at boot-time.
+
+config PRINTK_PROCESS
+	bool "Show process information on printks"
+	depends on PRINTK
+	help
+	  Selecting this option causes process to be
+	  included in printk output. Or add printk.process=1 at boot-time.
+
+
 config MESSAGE_LOGLEVEL_DEFAULT
 	int "Default message log level (1-7)"
 	range 1 7
```
