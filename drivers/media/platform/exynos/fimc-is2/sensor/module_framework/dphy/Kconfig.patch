## drivers/media/radio/Kconfig.patch
```kconfig
diff --git a/drivers/media/radio/Kconfig b/drivers/media/radio/Kconfig
index 192f36f2f4aa..a452eae7ad3e 100644
--- a/drivers/media/radio/Kconfig
+++ b/drivers/media/radio/Kconfig
@@ -10,6 +10,8 @@ menuconfig RADIO_ADAPTERS
 	---help---
 	  Say Y here to enable selecting AM/FM radio adapters.
 
+source "drivers/media/radio/si47xx/Kconfig"
+
 if RADIO_ADAPTERS && VIDEO_V4L2
 
 config RADIO_TEA575X
@@ -44,6 +46,12 @@ config RADIO_SI476X
 	  To compile this driver as a module, choose M here: the
 	  module will be called radio-si476x.
 
+config RADIO_RTC6213N
+	bool "RTC6213N FM Radio Receiver support"
+	depends on I2C && VIDEO_V4L2
+
+source "drivers/media/radio/rtc6213n/Kconfig"
+
 config USB_MR800
 	tristate "AverMedia MR 800 USB FM radio support"
 	depends on USB && VIDEO_V4L2
```

## drivers/media/v4l2-core/Kconfig.patch
```kconfig
diff --git a/drivers/media/v4l2-core/Kconfig b/drivers/media/v4l2-core/Kconfig
index ba7e21a73023..ba82b1ab52d7 100644
--- a/drivers/media/v4l2-core/Kconfig
+++ b/drivers/media/v4l2-core/Kconfig
@@ -93,6 +93,14 @@ config VIDEOBUF2_DMA_SG
 	select VIDEOBUF2_CORE
 	select VIDEOBUF2_MEMOPS
 
+config  VIDEOBUF2_ION
+	bool "Video buffer 2 by Android ION"
+	depends on ION_EXYNOS
+	select VIDEOBUF2_CORE
+	select VIDEOBUF2_MEMOPS
+	help
+	  Internal memory management for Video Buffer 2 by ION
+
 config VIDEOBUF2_DVB
 	tristate
 	select VIDEOBUF2_CORE
```

## drivers/memory/Kconfig.patch
```kconfig
diff --git a/drivers/memory/Kconfig b/drivers/memory/Kconfig
index 6d91c27fd4c8..907c30ea2ebb 100644
--- a/drivers/memory/Kconfig
+++ b/drivers/memory/Kconfig
@@ -4,9 +4,17 @@
 
 menuconfig MEMORY
 	bool "Memory Controller drivers"
+	default y
 
 if MEMORY
 
+config EXYNOS_MCOMP
+	bool "Exynos memory compressor"
+	default y
+	depends on ARCH_EXYNOS
+	help
+	  Memory compressor
+
 config ATMEL_SDRAMC
 	bool "Atmel (Multi-port DDR-)SDRAM Controller"
 	default y
```

## drivers/mfd/Kconfig.patch
```kconfig
diff --git a/drivers/mfd/Kconfig b/drivers/mfd/Kconfig
index 9e95b0991962..ea1f862f324c 100644
--- a/drivers/mfd/Kconfig
+++ b/drivers/mfd/Kconfig
@@ -420,6 +420,17 @@ config MFD_MAX77693
 	  additional drivers must be enabled in order to use the functionality
 	  of the device.
 
+config MFD_MAX77833
+        bool "Maxim Semiconductor MAX77833 PMIC Support"
+        depends on I2C=y
+        select MFD_CORE
+        help
+          Say yes here to support for Maxim Semiconductor MAX77833.
+          This is a Power Management IC with LDO, RGB(SVC led), Haptic,
+          MUIC controls on chip.
+          This driver provides common support for accessing the device;
+          additional drivers
+
 config MFD_MAX8907
 	tristate "Maxim Semiconductor MAX8907 PMIC Support"
 	select MFD_CORE
@@ -662,6 +673,71 @@ config MFD_SEC_CORE
 	 additional drivers must be enabled in order to use the functionality
 	 of the device
 
+config MFD_S2MU003
+	bool "SAMSUNG Electronics IF PMIC Series Support"
+	depends on I2C=y
+	select MFD_CORE
+	help
+	 Support for the Samsung Electronics MFD series.
+	 This driver provides common support for accessing the device,
+	 additional drivers must be enabled in order to use the functionality
+	 of the device
+
+config MFD_S2MPB02
+	bool "Samsung Semiconductor S2MPB02 PMIC Support"
+	depends on I2C=y
+	select MFD_CORE
+	help
+	  Say yes here to support for Samsung Semiconductor S2MPB02.
+	  This is a Power Management IC with Flash on chip.
+	  This driver provides common support for accessing the device;
+	  additional drivers
+
+config MFD_S2MU005
+	bool "SAMSUNG Electronics IF PMIC S2MU005 Series Support"
+	depends on I2C=y
+	select MFD_CORE
+	help
+	 Support for the Samsung Electronics MFD series.
+	 This driver provides common support for accessing the device,
+	 additional drivers must be enabled in order to use the functionality
+	 of the device
+
+#modified by khoonk on 2018.01.04
+if !IFPMIC_SUPPORT
+config MFD_S2MU004
+	bool "SAMSUNG Electronics IF PMIC S2MU004 Series Support"
+	depends on I2C=y
+	select MFD_CORE
+	help
+	 Support for the Samsung Electronics MFD series.
+	 This driver provides common support for accessing the device,
+	 additional drivers must be enabled in order to use the functionality
+	 of the device
+endif
+
+config MFD_SM5703
+	bool "Silicon Mitus SM5703 PMIC Support"
+	depends on I2C=y
+	select MFD_CORE
+	help
+	  Say yes here to support for Silicon Mitus SM5703.
+	  This is a Power Management IC with LDO, RGB(SVC led)
+	  controls on chip.
+	  This driver provides common support for accessing the device;
+	  additional drivers
+
+config MFD_SM5705
+	bool "Siliconmitus SM5705 IFPM Support"
+	depends on I2C=y
+	select MFD_CORE
+	help
+	  Say yes here to support for Siliconmitus SM5705.
+	  This is a Power Management IC with USBLDO, RGB(SVC led), Dual Flash, Charger
+	  controls on chip.
+	  This driver provides common support for accessing the device;
+	  additional drivers
+
 config MFD_SI476X_CORE
 	tristate "Silicon Laboratories 4761/64/68 AM/FM radio."
 	depends on I2C
@@ -1309,6 +1385,25 @@ config MFD_WM8994
 	  core support for the WM8994, in order to use the actual
 	  functionaltiy of the device other drivers must be enabled.
 
+
+config MFD_CS35L40
+	tristate "Cirrus Logic CS35L40 codec"
+	select MFD_CORE
+
+config MFD_CS35L40_SPI
+	tristate "Cirrus Logic CS35L40 codec (SPI)"
+	select MFD_CS35L40
+	select REGMAP_SPI
+	select REGMAP_IRQ
+	depends on SPI_MASTER
+
+config MFD_CS35L40_I2C
+	tristate "Cirrus Logic CS35L40 codec (I2C)"
+	select MFD_CS35L40
+	select REGMAP_I2C
+	select REGMAP_IRQ
+	depends on I2C
+
 config MFD_STW481X
 	tristate "Support for ST Microelectronics STw481x"
 	depends on I2C && ARCH_NOMADIK
```

## drivers/misc/Kconfig.patch
```kconfig
diff --git a/drivers/misc/Kconfig b/drivers/misc/Kconfig
index 878f09df7bf5..9b3fec617421 100644
--- a/drivers/misc/Kconfig
+++ b/drivers/misc/Kconfig
@@ -314,6 +314,12 @@ config ISL29003
 	  This driver can also be built as a module.  If so, the module
 	  will be called isl29003.
 
+config KNOX_KAP
+       bool "Enable KNOX KAP mode"
+       default n
+       help
+              Knox Active Protection mode
+
 config ISL29020
 	tristate "Intersil ISL29020 ambient light sensor"
 	depends on I2C
@@ -490,6 +496,18 @@ config USB_SWITCH_FSA9480
 	  stereo and mono audio, video, microphone and UART data to use
 	  a common connector port.
 
+config SD8XXX_RFKILL
+        tristate "Rfkill power control for Marvell sd8xxx wlan/bt"
+        depends on MARVELL_DRIVERS
+        select RFKILL
+        select WIRELESS_EXT
+        select WEXT_PRIV
+        select WEXT_SPY
+        default n
+        ---help---
+         Creates an rfkill entry in sysfs for power control of Marvell
+         sd8xxx wlan/bt chips.
+
 config LATTICE_ECP3_CONFIG
 	tristate "Lattice ECP3 FPGA bitstream configuration via SPI"
 	depends on SPI && SYSFS
@@ -526,6 +544,13 @@ config UID_SYS_STATS
 	  Per UID based cpu time statistics exported to /proc/uid_cputime
 	  Per UID based io statistics exported to /proc/uid_io
 
+config DEBUG_UID_CPUTIME
+	bool "Record each uid cputime"
+	depends on UID_SYS_STATS
+	default n
+	help
+	  Record each uid cputime for debugging
+
 config UID_SYS_STATS_DEBUG
 	bool "Per-TASK statistics"
 	depends on UID_SYS_STATS
@@ -539,6 +564,46 @@ config MEMORY_STATE_TIME
 	help
 	  Memory time statistics exported to /sys/kernel/memory_state_time
 
+config SAMSUNG_JACK
+	bool "3.5 PI Jack driver for Samsung devices"
+	depends on INPUT && INPUT_GPIO && SWITCH
+	default n
+	help
+	 This is 3.5 PI JACK driver for Samsung devies.
+	 sec_jack from samsung driver used for samsung devices.
+
+	 To samsung jack is reviewed and supported in all the
+	 samsung devices.
+
+config TIMA_LOG
+	tristate "Support for dumping TIMA log"
+	depends on TIMA
+	default y
+	help
+		This option enables support for dumping TIMA log.
+
+config LEDS_IRIS_IRLED_SUPPORT
+	tristate "this feature allows IRIS IRLED"
+	default n
+	help
+	  This is a driver for IRIS Led driver
+
+config LEDS_IRIS_FPGA_ICE40XX
+	tristate "this feature allows ICE40XX IRIS"
+	default n
+	help
+	  This is a driver for IRIS LEd driver based on Lattice chip.
+	  Lattice FPGA can support IRIS LED.
+	  To compile this driver as a module, choose M here.
+	  If unsure, say N.
+
+config LEDS_ICE40XX_POWER_CONTROL
+	tristate "this feature allows ICE40XX IRIS 1P2 PIN CONTROL"
+	default n
+	help
+	  This is a for driver for IRIS LEd driver based on Lattice chip.
+	  Lattice FPGA can support IRIS LED and this allow power control.
+
 source "drivers/misc/c2port/Kconfig"
 source "drivers/misc/eeprom/Kconfig"
 source "drivers/misc/cb710/Kconfig"
@@ -552,4 +617,10 @@ source "drivers/misc/mic/Kconfig"
 source "drivers/misc/genwqe/Kconfig"
 source "drivers/misc/echo/Kconfig"
 source "drivers/misc/cxl/Kconfig"
+source "drivers/misc/mcu_ipc/Kconfig"
+source "drivers/misc/uart_sel/Kconfig"
+source "drivers/misc/modem_v1/Kconfig"
+source "drivers/misc/gnss_if/Kconfig"
+source "drivers/misc/bhy/Kconfig"
+source "drivers/misc/tzdev/Kconfig"
 endmenu
```

## drivers/mmc/Kconfig.patch
```kconfig
diff --git a/drivers/mmc/Kconfig b/drivers/mmc/Kconfig
index f2eeb38efa65..a9fd0605b3c1 100644
--- a/drivers/mmc/Kconfig
+++ b/drivers/mmc/Kconfig
@@ -19,6 +19,16 @@ config MMC_DEBUG
 	  This is an option for use by developers; most people should
 	  say N here.  This enables MMC core and driver debugging.
 
+config MMC_BLOCK_DEFERRED_RESUME
+	bool "Enable Deferred Resume"
+	depends on MMC != n
+	default n
+
+config MMC_SUPPORT_STLOG
+	bool "Enable storage log"
+	depends on MMC && PROC_STLOG
+	default y
+
 if MMC
 
 source "drivers/mmc/core/Kconfig"
```

## drivers/mmc/host/Kconfig.patch
```kconfig
diff --git a/drivers/mmc/host/Kconfig b/drivers/mmc/host/Kconfig
index 13860656104b..366a86b51293 100644
--- a/drivers/mmc/host/Kconfig
+++ b/drivers/mmc/host/Kconfig
@@ -580,12 +580,30 @@ config SDH_BFIN_MISSING_CMD_PULLUP_WORKAROUND
 config MMC_DW
 	tristate "Synopsys DesignWare Memory Card Interface"
 	depends on HAS_DMA
-	depends on ARC || ARM || MIPS || COMPILE_TEST
+	depends on ARC || ARM || ARM64 || MIPS || COMPILE_TEST
 	help
 	  This selects support for the Synopsys DesignWare Mobile Storage IP
 	  block, this provides host support for SD and MMC interfaces, in both
 	  PIO and external DMA modes.
 
+config MMC_DW_FMP_DM_CRYPT
+	bool "FMP acceleration for DM_CRYPT"
+	depends on DM_CRYPT
+	select FMP_MMC
+	select FMP_DM_CRYPT
+	help
+	  This option accelerates dm-crypt by using the flash
+	  memory protector feature of the eMMC controller.
+
+config MMC_DW_FMP_ECRYPT_FS
+	bool "FMP acceleration for eCrypt filesystem"
+	depends on ECRYPT_FS
+	select FMP_MMC
+	select FMP_ECRYPT_FS
+	help
+	  This option activates flash memory protector of the eMMC controller to
+	  accelerate eCryptfs.
+
 config MMC_DW_IDMAC
 	bool "Internal DMAC interface"
 	depends on MMC_DW
@@ -594,6 +612,14 @@ config MMC_DW_IDMAC
 	  Designware Mobile Storage IP block. This disables the external DMA
 	  interface.
 
+config MMC_DW_64BIT_DESC
+	bool "64bit desctriptor interface"
+	depends on MMC_DW
+	help
+	  This selects support for the 64bit internal DMAC block within the Synopsys
+	  Designware Mobile Storage IP block. This disables the 32bit internal DMA
+	  interface.
+
 config MMC_DW_PLTFM
 	tristate "Synopsys Designware MCI Support as platform device"
 	depends on MMC_DW
@@ -617,6 +643,21 @@ config MMC_DW_EXYNOS
 	  Synopsys DesignWare Memory Card Interface driver. Select this option
 	  for platforms based on Exynos4 and Exynos5 SoC's.
 
+config MMC_DW_EXYNOS_EMMC_SHUTDOWN_POWERCTRL
+	tristate "Exynos specific extensions for Synopsys DWMCI needed eMMC shutdown power off"
+	depends on MMC_DW_EXYNOS
+	select MMC_DW_PLTFM
+	help
+	  This selects support for Samsung Exynos SoC specific extensions to the
+	  Synopsys DesignWare Memory Card Interface driver.
+
+config MMC_DW_DEBUG
+	bool "Samsung DWMCI debug feature"
+	depends on MMC_DW
+	help
+	  This selects support for infomation logging for debugging.
+	  Select this option if this feature is needed on working.
+
 config MMC_DW_K3
 	tristate "K3 specific extensions for Synopsys DW Memory Card Interface"
 	depends on MMC_DW
@@ -647,6 +688,14 @@ config MMC_DW_ROCKCHIP
 	  Synopsys DesignWare Memory Card Interface driver. Select this option
 	  for platforms based on RK3066, RK3188 and RK3288 SoC's.
 
+config MMC_DW_FORCE_32BIT_SFR_RW
+	bool "Force to use 32bit rw for 64bit SFR rw"
+	depends on MMC_DW
+	help
+	  This selects converting 64bit SFR read/write by two separate 32bit
+	  read/write when 64bit read/write is not allowed for SFR on some DW
+	  MMC implementation. Consider using this with FIFO SFR on PIO mode.
+
 config MMC_SH_MMCIF
 	tristate "SuperH Internal MMCIF support"
 	depends on MMC_BLOCK && HAS_DMA
@@ -748,3 +797,10 @@ config MMC_SUNXI
 	help
 	  This selects support for the SD/MMC Host Controller on
 	  Allwinner sunxi SoCs.
+	  
+config MMC_TUNING_ALL_PASS_QUIRK
+    bool "Check if all passed before for tuning fail case"
+    default n
+    help
+      If tuning failed with lowest driver strength but passed for all phase with previous driver strength,
+      do not treat the card as tuning failed. Select timing based on all pass case.
```
