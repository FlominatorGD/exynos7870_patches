## drivers/hid/Kconfig.patch
```kconfig
diff --git a/drivers/hid/Kconfig b/drivers/hid/Kconfig
index 6f299cd54e6d..93d99ae750ec 100644
--- a/drivers/hid/Kconfig
+++ b/drivers/hid/Kconfig
@@ -746,6 +746,13 @@ config SMARTJOYPLUS_FF
 	Say Y here if you have a SmartJoy PLUS PS2/USB adapter and want to
 	enable force feedback support for it.
 
+config HID_SYNAPTICS_BT
+	tristate "HID Synaptics"
+	depends on HID
+	default n
+	---help---
+	For a Bluetooth HID touchpad
+
 config HID_TIVO
 	tristate "TiVo Slide Bluetooth remote control support"
 	depends on HID
```

## drivers/i2c/busses/Kconfig.patch
```kconfig
diff --git a/drivers/i2c/busses/Kconfig b/drivers/i2c/busses/Kconfig
index 06e99eb64295..d1c48b15cf53 100644
--- a/drivers/i2c/busses/Kconfig
+++ b/drivers/i2c/busses/Kconfig
@@ -725,6 +725,13 @@ config I2C_S3C2410
 	  Say Y here to include support for I2C controller in the
 	  Samsung SoCs.
 
+config FIX_I2C_BUS_NUM
+	bool "Fix I2C bus number"
+	depends on I2C_S3C2410
+	default n
+	help
+	   This will fix I2C bus number.
+
 config I2C_SH7760
 	tristate "Renesas SH7760 I2C Controller"
 	depends on CPU_SUBTYPE_SH7760
```

## drivers/iio/Kconfig.patch
```kconfig
diff --git a/drivers/iio/Kconfig b/drivers/iio/Kconfig
index 345395e9dc6e..428ca98e53dd 100644
--- a/drivers/iio/Kconfig
+++ b/drivers/iio/Kconfig
@@ -77,5 +77,6 @@ endif #IIO_TRIGGER
 source "drivers/iio/pressure/Kconfig"
 source "drivers/iio/proximity/Kconfig"
 source "drivers/iio/temperature/Kconfig"
+source "drivers/iio/inv_test/Kconfig"
 
 endif # IIO
```

## drivers/input/Kconfig.patch
```kconfig
diff --git a/drivers/input/Kconfig b/drivers/input/Kconfig
index eaa208f377ff..2f168528b1dd 100644
--- a/drivers/input/Kconfig
+++ b/drivers/input/Kconfig
@@ -181,6 +181,27 @@ config INPUT_KEYRESET
 	---help---
 	  Say Y here if you want to reboot when some keys are pressed;
 
+config GLOVE_TOUCH
+	tristate "Glove touch"
+	help
+	  Say Y here if you want glove touch.
+
+config INPUT_TOUCHSCREEN_TCLM
+	bool "touchscreen tclm"
+	depends on I2C
+	help
+	  Say Y here if you need to use tclm.
+
+	  If unsure, say N.
+
+config INPUT_TOUCHSCREEN_TCLMV2
+	bool "touchscreen tclmv2"
+	depends on I2C
+	help
+	  Say Y here if you need to use tclm.
+
+	  If unsure, say N.
+
 config INPUT_KEYCOMBO
 	tristate "Key combo"
 	depends on INPUT
@@ -190,6 +211,61 @@ config INPUT_KEYCOMBO
 	  To compile this driver as a module, choose M here: the
 	  module will be called keycombo.
 
+config HALL
+	tristate "Enable HALL"
+	default n
+	help
+	  Enable Hall Feature
+
+config HALL_NOTIFIER
+	bool "HALL notifier support"
+	depends on HALL
+	default n
+	help
+	  If you say yes here you will get support for
+	  the HALL status change notification.
+	  
+config SEC_FLIP_WORK_DOUBLE_CHECK
+	tristate "Enable flip work is checked twice"
+	default n
+	help
+	  Enable SEC_FLIP_WORK_DOUBLE_CHECK Feature	 	  
+
+config CHECK_BOOKCOVER_HALL
+	tristate "Enable to check BookCover HALL"
+	default n
+	help
+	  Enable to check BookCover hall detect Feature
+
+config HALL_EVENT_REVERSE
+	tristate "Adjusting the status value of HALL IC"
+	default y
+	depends on HALL
+	depends on ANDROID_MAJOR_VERSION >= "q"
+	help
+	  Adjusting the status value of HALL IC.
+	  This was required from input FW.
+
+	  If unsure, say N.
+
+config CERTIFY_HALL
+	tristate "Enable CERTIFY HALL"
+	default n
+	help
+	  Enable Certify Hall Feature
+
+config SEC_AUTO_INPUT
+	tristate "Samsung auto input"
+	depends on !SAMSUNG_PRODUCT_SHIP
+	default y
+	help
+	  Say Y here if you use auto input function.
+
+	  If unsure, say N.
+
+	  To compile this driver as a module, choose M here: the
+	  module will be called autoinput.
+
 comment "Input Device Drivers"
 
 source "drivers/input/keyboard/Kconfig"
@@ -202,6 +278,8 @@ source "drivers/input/tablet/Kconfig"
 
 source "drivers/input/touchscreen/Kconfig"
 
+source "drivers/input/wacom/Kconfig"
+
 source "drivers/input/misc/Kconfig"
 
 endif
```
