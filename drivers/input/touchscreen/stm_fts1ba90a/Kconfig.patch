## drivers/iommu/Kconfig.patch
```kconfig
diff --git a/drivers/iommu/Kconfig b/drivers/iommu/Kconfig
index dd5112265cc9..00e35df5447d 100644
--- a/drivers/iommu/Kconfig
+++ b/drivers/iommu/Kconfig
@@ -172,8 +172,10 @@ config TEGRA_IOMMU_SMMU
 	  space through the SMMU (System Memory Management Unit)
 	  hardware included on Tegra SoCs.
 
+# EXYNOS IOMMU support
 config EXYNOS_IOMMU
-	bool "Exynos IOMMU Support"
+	bool "IOMMU for Exynos"
+	default y
 	depends on ARCH_EXYNOS
 	select IOMMU_API
 	select ARM_DMA_USE_IOMMU
@@ -183,7 +185,20 @@ config EXYNOS_IOMMU
 	  non-linear physical memory chunks as linear memory in their
 	  address space.
 
-	  If unsure, say N here.
+config EXYNOS_IOVMM
+	bool "IO Virtual Memory Manager for Exynos IOMMU"
+	depends on EXYNOS_IOMMU
+	default y
+	help
+	  Supporting the users of Exynos IOMMU for allocating and mapping
+	  an IO virtual memory region with a physical memory region
+	  and managing the allocated virtual memory regions.
+	  This config supports SYSMMU V6 version.
+
+config EXYNOS_IOMMU_EVENT_LOG
+	bool "Logging System MMU events in private uncached buffer"
+	depends on EXYNOS_IOMMU
+	default y
 
 config EXYNOS_IOMMU_DEBUG
 	bool "Debugging log for Exynos IOMMU"
```

## drivers/leds/Kconfig.patch
```kconfig
diff --git a/drivers/leds/Kconfig b/drivers/leds/Kconfig
index a210338cfeb1..9bcb9c3d176e 100644
--- a/drivers/leds/Kconfig
+++ b/drivers/leds/Kconfig
@@ -505,6 +505,93 @@ config LEDS_VERSATILE
 	  This option enabled support for the LEDs on the ARM Versatile
 	  and RealView boards. Say Y to enabled these.
 
+config LEDS_S2MPB02
+	bool "LED support for the S2MPB02"
+	depends on LEDS_CLASS
+	help
+	  This option enables support for the LEDs on the S2MPB02.
+
+config LEDS_S2MU003
+	bool "LED support for the S2MU003"
+	depends on LEDS_CLASS
+	help
+	  This option enables support for the LEDs on the S2MU003.
+
+config S2MU003_LEDS_I2C
+	bool "LED support for the S2MU003"
+	depends on LEDS_S2MU003
+	help
+	  This option enables support for the LEDs on the S2MU003.
+
+config LEDS_S2MU005_FLASH
+	bool "LED support for the S2MU005"
+	depends on LEDS_CLASS
+	help
+	  This option enables support for the LEDs on the S2MU005.
+
+config LEDS_S2MU005_RGB
+	bool "LED driver for S2MU005 RGB"
+	help
+	  Use LED driver for S2MU005 RGB
+	  If unsure, say N
+	  
+
+config S2MU005_LEDS_I2C
+	bool "LED support for the S2MU005"
+	help
+	  This option enables support for the LEDs on the S2MU005.
+
+config LEDS_SM5705
+	bool "LED support for the SM5705"
+	depends on LEDS_CLASS
+	help
+	  This option enables support for the LEDs on the SM5705.
+
+config FLASHLIGHT
+	bool "Flashlight Support"
+	help
+	  This option enables the led sysfs class in /sys/class/flashlight.
+
+config SM_FLASH_LED
+	tristate "Siliconmitus flash LED driver support"
+	depends on FLASHLIGHT
+	help
+	  Say Y here to enable Siliconmitus's flash LED driver HAL architecture
+
+config FLED_SM5703
+	tristate "Siliconmitus SM5703 flash LED driver"
+	depends on SM_FLASH_LED
+	help
+	  A driver for Siliconmitus SM5703 flash LED
+
+config LEDS_SUPPORT_FRONT_FLASH
+	bool "LED support for Front Flash"
+	help
+	  This option enables support for the LEDs.
+
+config LEDS_SUPPORT_FRONT_FLASH_AUTO
+	bool "LED support for Front Flash Auto Mode"
+	help
+	  This option enables support for the LEDs.
+
+config LEDS_RT8547
+	bool "LED support for the RT8547"
+	help
+	  If you say yes here you will get support for
+	  for the RT8547 FLASH led chip.
+
+config LEDS_IRIS_IRLED_KTD2692
+	bool "IRLED support for the KTD2692"
+	help
+	  If you say yes here you will get support for
+	  for the KTD2692 FLASH led chip.
+
+config LEDS_KTD2692
+	bool "LED support for the KTD2692 Flash driver"
+	help
+	  If you say yes here you will get support for
+	  for the KTD2692 FLASH led chip.	  
+
 comment "LED Triggers"
 source "drivers/leds/trigger/Kconfig"
 
```

## drivers/media/Kconfig.patch
```kconfig
diff --git a/drivers/media/Kconfig b/drivers/media/Kconfig
index 3c89fcbc621e..069c1c262d21 100644
--- a/drivers/media/Kconfig
+++ b/drivers/media/Kconfig
@@ -80,6 +80,16 @@ config MEDIA_RC_SUPPORT
 
 	  Say Y when you have a TV or an IR device.
 
+config MEDIA_M2M1SHOT
+	bool "Non-streaming m2m media processing (m2m1shot) API"
+	---help---
+	  Enables support for non-steaming m2m media processing API for some
+	  device drivers like JPEG codec.
+
+config MEDIA_M2M1SHOT_TESTDEV
+	depends on MEDIA_M2M1SHOT
+	bool "Test driver for non-streaming m2m media processing (m2m1shot) API"
+
 #
 # Media controller
 #	Selectable only for webcam/grabbers, as other drivers don't use it
@@ -209,4 +219,16 @@ source "drivers/media/i2c/Kconfig"
 source "drivers/media/tuners/Kconfig"
 source "drivers/media/dvb-frontends/Kconfig"
 
+#
+# TDMB drivers
+#
+
+source "drivers/media/tdmb/Kconfig"
+
+# ISDBT Drivers
+source "drivers/media/isdbt/Kconfig"
+
+# MTV driver support
+source "drivers/media/mtv/Kconfig"
+
 endif # MEDIA_SUPPORT
```

## drivers/media/platform/Kconfig.patch
```kconfig
diff --git a/drivers/media/platform/Kconfig b/drivers/media/platform/Kconfig
index 736277236ba2..59b993e7e25f 100644
--- a/drivers/media/platform/Kconfig
+++ b/drivers/media/platform/Kconfig
@@ -33,6 +33,8 @@ source "drivers/media/platform/omap/Kconfig"
 
 source "drivers/media/platform/blackfin/Kconfig"
 
+source "drivers/media/platform/exynos/Kconfig"
+
 config VIDEO_SH_VOU
 	tristate "SuperH VOU video output driver"
 	depends on MEDIA_CAMERA_SUPPORT
```
