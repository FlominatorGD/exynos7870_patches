## drivers/rtc/Kconfig.patch
```kconfig
diff --git a/drivers/rtc/Kconfig b/drivers/rtc/Kconfig
index 2f69f27c017b..d63d462906e3 100644
--- a/drivers/rtc/Kconfig
+++ b/drivers/rtc/Kconfig
@@ -1034,6 +1034,23 @@ config RTC_DRV_S3C
 	  This driver can also be build as a module. If so, the module
 	  will be called rtc-s3c.
 
+config RTC_DRV_SEC
+	tristate "Samsung PMIC series RTC"
+	depends on MFD_SEC_CORE
+	help
+	  If you say yes here you will get support for the
+	  RTC of Samsung PMIC series.
+	  This driver can also be built as a module. If so, the module
+	  will be called rtc-sec.
+
+config RTC_ALARM_BOOT
+	bool "Android alarm boot function"
+	depends on RTC_DRV_SEC
+	default n
+	help
+	  This is for alarm booting function. This feature is only used in
+	  Chinese models.
+
 config RTC_DRV_EP93XX
 	tristate "Cirrus Logic EP93XX"
 	depends on ARCH_EP93XX
@@ -1415,6 +1432,13 @@ config RTC_DRV_XGENE
 
 comment "HID Sensor RTC drivers"
 
+config S2MU005_ACOK_NOTIFY
+	tristate "notify charger interrupt by PMIC"
+	default n
+	help
+	  Say Y to include support
+	  for S.LSI S2MU005 fuel gauge driver.
+	  
 config RTC_DRV_HID_SENSOR_TIME
 	tristate "HID Sensor Time"
 	depends on USB_HID
```

## drivers/scsi/Kconfig.patch
```kconfig
diff --git a/drivers/scsi/Kconfig b/drivers/scsi/Kconfig
index 3a820f61ce65..47bda3ae5e25 100644
--- a/drivers/scsi/Kconfig
+++ b/drivers/scsi/Kconfig
@@ -36,6 +36,20 @@ config SCSI
 	  However, do not compile this as a module if your root file system
 	  (the one containing the directory /) is located on a SCSI device.
 
+config UFS_FMP_DM_CRYPT
+	bool "FMP acceleration for DM_CRYPT"
+	depends on DM_CRYPT && FMP_UFS
+	help
+	  This option accelerates dm-crypt by using the flash
+	  memory protector feature of the UFS controller.
+
+config UFS_FMP_ECRYPT_FS
+	bool "FMP acceleration for eCrypt filesystem"
+	depends on ECRYPT_FS && FMP_UFS
+	help
+	  This option activates flash memory protector of the UFS controller to
+	  accelerate eCryptfs.
+
 config SCSI_DMA
 	bool
 	default n
```

## drivers/scsi/ufs/Kconfig.patch
```kconfig
diff --git a/drivers/scsi/ufs/Kconfig b/drivers/scsi/ufs/Kconfig
index 6e07b2afddeb..c4ff7075d598 100644
--- a/drivers/scsi/ufs/Kconfig
+++ b/drivers/scsi/ufs/Kconfig
@@ -35,8 +35,6 @@
 config SCSI_UFSHCD
 	tristate "Universal Flash Storage Controller Driver Core"
 	depends on SCSI && SCSI_DMA
-	select PM_DEVFREQ
-	select DEVFREQ_GOV_SIMPLE_ONDEMAND
 	---help---
 	This selects the support for UFS devices in Linux, say Y and make
 	  sure that you know the name of your UFS host adapter (the card
@@ -49,6 +47,10 @@ config SCSI_UFSHCD
 	  However, do not compile this as a module if your root file system
 	  (the one containing the directory /) is located on a UFS device.
 
+config UFS_DYNAMIC_H8
+	bool "UFS Dynamic Hibernation (EXPERIMENTAL)"
+	depends on SCSI_UFSHCD
+
 config SCSI_UFSHCD_PCI
 	tristate "PCI bus based UFS Controller support"
 	depends on SCSI_UFSHCD && PCI
@@ -58,6 +60,14 @@ config SCSI_UFSHCD_PCI
 
 	  If you have a controller with this interface, say Y or M here.
 
+config SCSI_SKIP_CACHE_OP
+	bool "Skip operations for cache coherency"
+	depends on SCSI_UFSHCD
+	---help---
+	  This selects support for skipping operations for cache coherency
+
+	  to reduce I/O overhead if file system layer do same thing.
+
 	  If unsure, say N.
 
 config SCSI_UFSHCD_PLATFORM
@@ -70,3 +80,13 @@ config SCSI_UFSHCD_PLATFORM
 	If you have a controller with this interface, say Y or M here.
 
 	  If unsure, say N.
+
+config SCSI_UFS_EXYNOS
+	tristate "EXYNOS UFS Host Controller Driver"
+	depends on SCSI_UFSHCD && SCSI_UFSHCD_PLATFORM
+	---help---
+	  This selects the EXYNOS UFS host controller driver.
+
+	  If you have a controller with this interface, say Y or M here.
+
+	  If unsure, say N.
```

## drivers/soc/Kconfig.patch
```kconfig
diff --git a/drivers/soc/Kconfig b/drivers/soc/Kconfig
index 76d6bd4da138..90f33b9ce7b5 100644
--- a/drivers/soc/Kconfig
+++ b/drivers/soc/Kconfig
@@ -3,5 +3,6 @@ menu "SOC (System On Chip) specific Drivers"
 source "drivers/soc/qcom/Kconfig"
 source "drivers/soc/ti/Kconfig"
 source "drivers/soc/versatile/Kconfig"
+source "drivers/soc/samsung/Kconfig"
 
 endmenu
```

## drivers/spi/Kconfig.patch
```kconfig
diff --git a/drivers/spi/Kconfig b/drivers/spi/Kconfig
index 84e7c9e6ccef..cfc5bd39d729 100644
--- a/drivers/spi/Kconfig
+++ b/drivers/spi/Kconfig
@@ -444,8 +444,8 @@ config SPI_S3C24XX_FIQ
 
 config SPI_S3C64XX
 	tristate "Samsung S3C64XX series type SPI"
-	depends on PLAT_SAMSUNG
-	select S3C64XX_PL080 if ARCH_S3C64XX
+	depends on ARCH_EXYNOS && OF
+	default y
 	help
 	  SPI driver for Samsung S3C64XX and newer SoCs.
 
@@ -588,6 +588,11 @@ config SPI_NUC900
 	help
 	  SPI driver for Nuvoton NUC900 series ARM SoCs
 
+config SENSORS_FP_SPI_NUMBER
+	depends on SENSORS_FINGERPRINT
+	int "Fingerprint spi gpio number"
+	default 0
+
 #
 # Add new SPI master controllers in alphabetical order above this line
 #
```

## drivers/staging/Kconfig.patch
```kconfig
diff --git a/drivers/staging/Kconfig b/drivers/staging/Kconfig
index 4690ae9a267f..f14a90bf759c 100644
--- a/drivers/staging/Kconfig
+++ b/drivers/staging/Kconfig
@@ -108,4 +108,10 @@ source "drivers/staging/skein/Kconfig"
 
 source "drivers/staging/unisys/Kconfig"
 
+source "drivers/staging/samsung/Kconfig"
+
+source "drivers/staging/vnswap/Kconfig"
+
+source "drivers/staging/sti/Kconfig"
+
 endif # STAGING
```

## drivers/staging/android/Kconfig.patch
```kconfig
diff --git a/drivers/staging/android/Kconfig b/drivers/staging/android/Kconfig
index 07f21984d8d7..4a0faab7b9f4 100644
--- a/drivers/staging/android/Kconfig
+++ b/drivers/staging/android/Kconfig
@@ -20,9 +20,8 @@ config ANDROID_BINDER_IPC
 	  between said processes.
 
 config ANDROID_BINDER_IPC_32BIT
-	bool
-	depends on !64BIT && ANDROID_BINDER_IPC
-	default y
+	bool "Use old 32-bit binder api"
+        default y if ANDROID_MAJOR_VERSION != "o" && ANDROID_MAJOR_VERSION != "p" && ANDROID_MAJOR_VERSION != "q"
 	---help---
 	  The Binder API has been changed to support both 32 and 64bit
 	  applications in a mixed environment.
@@ -66,6 +65,24 @@ config ASHMEM
 	  It is, in theory, a good memory allocator for low-memory devices,
 	  because it can discard shared memory units when under memory pressure.
 
+config ANDROID_LOGGER
+	tristate "Android log driver"
+	default n
+	depends on !EXYNOS_SNAPSHOT_PSTORE
+	---help---
+	  This adds support for system-wide logging using four log buffers.
+
+	  These are:
+
+	      1: main
+	      2: events
+	      3: radio
+	      4: system
+
+	  Log reading and writing is performed via normal Linux reads and
+	  optimized writes. This optimization avoids logging having too
+	  much overhead in the system.
+
 config ANDROID_TIMED_OUTPUT
 	bool "Timed output class driver"
 	default y
@@ -89,6 +106,15 @@ config ANDROID_LOW_MEMORY_KILLER_AUTODETECT_OOM_ADJ_VALUES
 	  /sys/module/lowmemorykiller/parameters/adj and convert them
 	  to oom_score_adj values.
 
+config ANDROID_INTF_ALARM_DEV
+	tristate "Android alarm driver"
+	depends on RTC_CLASS
+	default n
+	---help---
+	  Provides non-wakeup and rtc backed wakeup alarms based on rtc or
+	  elapsed realtime, and a non-wakeup alarm on the monotonic clock.
+	  Also exports the alarm interface to user-space.
+
 config SYNC
 	bool "Synchronization framework"
 	default n
@@ -128,6 +154,7 @@ config ANDROID_VSOC
 
 source "drivers/staging/android/ion/Kconfig"
 
+
 endif # if ANDROID
 
 endmenu
```
