## drivers/net/wireless/Kconfig.patch
```kconfig
diff --git a/drivers/net/wireless/Kconfig b/drivers/net/wireless/Kconfig
index 16604bdf5197..d9eadb5602ac 100644
--- a/drivers/net/wireless/Kconfig
+++ b/drivers/net/wireless/Kconfig
@@ -265,9 +265,50 @@ config MWL8K
 	  To compile this driver as a module, choose M here: the module
 	  will be called mwl8k.  If unsure, say N.
 
+config QCOM_WIFI
+	bool "Qualcomm WiFi Driver"
+	depends on WLAN
+	default n
+	---help---
+	  This is a configuration for qualcomm WLAN driver.
+	  
+config QCA9377_LDO_RESET
+	bool "QCA9377 LDO flag for recovery"
+	default n
+	---help---
+	  This is a configuration for qualcomm WLAN LDO issue.
+
+config WLAN_QCA9377_DUAL_BDF
+	int "QCA9377 DUAL bdf issue for HW change"
+	default 0
+	---help---
+	  This is a configuration for HW change issue.
+
+config CNSS_SDIO
+	tristate "Flag to enable platform driver for SIDO based wifi device"
+	depends on MMC_DW
+	depends on MMC_DW_EXYNOS
+	---help---
+	  This module specifies whether CNSS Platform Driver supports SDIO.
+	  This flag needs to be disabled if CNSS platform Driver need to be
+	  supported for other buses.
+	  This Flag is used by CLD Driver to use the SDIO GPL API's through
+	  CNSS Platform Driver.
+
+config WLAN_SSR_ENABLED
+	bool "Enable SSR for recovery"
+	default n
+
+config WCNSS_MEM_PRE_ALLOC
+	tristate "WCNSS pre-alloc memory support"
+	---help---
+	  Pre-allocate memory for the WLAN driver module
+
 source "drivers/net/wireless/ath/Kconfig"
 source "drivers/net/wireless/b43/Kconfig"
 source "drivers/net/wireless/b43legacy/Kconfig"
+source "drivers/net/wireless/bcmdhd/Kconfig"
+source "drivers/net/wireless/bcmdhd_1_77/Kconfig"
 source "drivers/net/wireless/brcm80211/Kconfig"
 source "drivers/net/wireless/hostap/Kconfig"
 source "drivers/net/wireless/ipw2x00/Kconfig"
@@ -283,5 +324,6 @@ source "drivers/net/wireless/zd1211rw/Kconfig"
 source "drivers/net/wireless/mwifiex/Kconfig"
 source "drivers/net/wireless/cw1200/Kconfig"
 source "drivers/net/wireless/rsi/Kconfig"
+source "drivers/net/wireless/qcacld-2.0/Kconfig"
 
 endif # WLAN
```

## drivers/nfc/Kconfig.patch
```kconfig
diff --git a/drivers/nfc/Kconfig b/drivers/nfc/Kconfig
index 7929fac13e1c..510ae5d80252 100644
--- a/drivers/nfc/Kconfig
+++ b/drivers/nfc/Kconfig
@@ -2,8 +2,41 @@
 # Near Field Communication (NFC) devices
 #
 
-menu "Near Field Communication (NFC) devices"
-	depends on NFC
+config SAMSUNG_NFC
+	bool "Samsung NFC driver"
+	default n
+	help
+	  Say Y here if you want to build support for NFC (Near field
+	  communication) devices.
+	  To compile this support as a module, choose M here: the module will
+	  be called nfc.
+
+config ESE_P3_LSI
+        bool "Oberthur ese driver"
+        depends on SPI
+        default n
+        help
+          Oberthur Driver.
+          This driver provides support for LSI NXP combined ESE products.
+          You should select your NFC product and interface.
+
+config ESE_SECURE
+        bool "ESE Secure Controller Driver"
+        default n
+        help
+          Common eSE Secure controller support.
+          This option enables device driver support for the eSE with NFC.
+          It is used by many services. eSE is fully controlled using SPI
+          to communication
+
+config ESE_SECURE_SPI_PORT
+        int "ese spi port number"
+        depends on ESE_SECURE 
+        default 99
+
+config ESE_SECURE_GPIO
+        depends on ESE_SECURE
+        string "gpio group for ese"
 
 config NFC_PN533
 	tristate "NXP PN533 USB driver"
@@ -68,9 +101,51 @@ config NFC_PORT100
 
 	  If unsure, say N.
 
+config NFC_FELICA
+        bool "NFC Felica support driver"
+        default n
+        help
+          N5 driver can support addtional specification for Felica.
+
 source "drivers/nfc/pn544/Kconfig"
 source "drivers/nfc/microread/Kconfig"
 source "drivers/nfc/nfcmrvl/Kconfig"
 source "drivers/nfc/st21nfca/Kconfig"
 source "drivers/nfc/st21nfcb/Kconfig"
-endmenu
+
+config SEC_NFC
+	bool "Samsung NFC driver"
+	default n
+	help
+	  SAMSUNG NFC Driver.
+	  This driver provides support for SAMSUNG NFC products.
+	  You should select your NFC product and interface.
+
+	  Say Y here to compile support for SAMSUNG NFC driver into the
+	  kernel.
+
+choice
+	prompt "SEC NFC Products"
+	depends on SEC_NFC
+config SEC_NFC_PRODUCT_N5
+	bool "N5"
+endchoice
+choice
+	prompt "SEC NFC Interface"
+	depends on SEC_NFC
+config SEC_NFC_IF_I2C
+	bool "I2C"
+	depends on SEC_NFC_PRODUCT_N5
+endchoice
+config SEC_NFC_LDO_CONTROL
+	bool "SEC NFC LDO CONTROL"
+	depends on SEC_NFC
+	default n
+	help
+	  SAMSUNG SEC NFC LDO CONTROL feature.
+	  This feature provides support for SAMSUNG NFC products.
+	  You should select this feature if your NFC product uses ldo control of i2c.
+
+	  Say Y here to compile support for SEC NFC LDO CONTROL feature into the
+	  kernel.
+
```

## drivers/pci/host/Kconfig.patch
```kconfig
diff --git a/drivers/pci/host/Kconfig b/drivers/pci/host/Kconfig
index 3dc25fad490c..424a9e4c50ac 100644
--- a/drivers/pci/host/Kconfig
+++ b/drivers/pci/host/Kconfig
@@ -20,10 +20,14 @@ config PCIE_DW
 
 config PCI_EXYNOS
 	bool "Samsung Exynos PCIe controller"
-	depends on SOC_EXYNOS5440
+	depends on SOC_EXYNOS8890
 	select PCIEPORTBUS
 	select PCIE_DW
 
+config PCI_EXYNOS_TEST
+	bool "EXYNOS PCIe driver test"
+	depends on PCI_EXYNOS
+
 config PCI_IMX6
 	bool "Freescale i.MX6 PCIe controller"
 	depends on SOC_IMX6Q
```

## drivers/pci/pcie/Kconfig.patch
```kconfig
diff --git a/drivers/pci/pcie/Kconfig b/drivers/pci/pcie/Kconfig
index 7958e59d6077..cb9d4f08f846 100644
--- a/drivers/pci/pcie/Kconfig
+++ b/drivers/pci/pcie/Kconfig
@@ -30,7 +30,7 @@ source "drivers/pci/pcie/aer/Kconfig"
 config PCIEASPM
 	bool "PCI Express ASPM control" if EXPERT
 	depends on PCI && PCIEPORTBUS
-	default y
+	default n
 	help
 	  This enables OS control over PCI Express ASPM (Active State
 	  Power Management) and Clock Power Management. ASPM supports
```

## drivers/phy/Kconfig.patch
```kconfig
diff --git a/drivers/phy/Kconfig b/drivers/phy/Kconfig
index 2a436e607f99..5d5c8ed7aa26 100644
--- a/drivers/phy/Kconfig
+++ b/drivers/phy/Kconfig
@@ -32,6 +32,15 @@ config PHY_EXYNOS_MIPI_VIDEO
 	  Support for MIPI CSI-2 and MIPI DSI DPHY found on Samsung S5P
 	  and EXYNOS SoCs.
 
+config PHY_EXYNOS_MIPI
+	tristate "Samsung EXYNOS SoC MIPI CSI/DSI PHY driver"
+	depends on HAS_IOMEM
+	depends on  ARCH_EXYNOS && OF || COMPILE_TEST
+	select GENERIC_PHY
+	help
+	  Support for MIPI CSI and MIPI DSI DPHY found on Samsung
+	  and EXYNOS SoCs.
+
 config PHY_MVEBU_SATA
 	def_bool y
 	depends on ARCH_DOVE || MACH_DOVE || MACH_KIRKWOOD
@@ -204,6 +213,27 @@ config PHY_EXYNOS5_USBDRD
 	  This driver provides PHY interface for USB 3.0 DRD controller
 	  present on Exynos5 SoC series.
 
+config PHY_EXYNOS_USBDRD
+	tristate "Exynos SoC series USB DRD PHY driver"
+	depends on ARCH_EXYNOS && OF
+	depends on HAS_IOMEM
+	depends on USB_DWC3_EXYNOS
+	select GENERIC_PHY
+	select MFD_SYSCON
+	default y
+	help
+	  Enable USB DRD PHY support for Exynos SoC series.
+	  This driver provides PHY interface for USB 3.0 DRD controller
+	  present on Exynos SoC series.
+
+config PHY_SAMSUNG_USB_CAL
+	bool "Samsung USB PHY CAL"
+	depends on PHY_EXYNOS_USBDRD
+	default y
+	help
+	  Enable this to support CAL (Chip Abstraction Layer)
+	  for Samsung USB PHY controller.
+
 config PHY_QCOM_APQ8064_SATA
 	tristate "Qualcomm APQ8064 SATA SerDes/PHY driver"
 	depends on ARCH_QCOM
```

## drivers/pinctrl/Kconfig.patch
```kconfig
diff --git a/drivers/pinctrl/Kconfig b/drivers/pinctrl/Kconfig
index b916a0eb799f..c0e651538325 100644
--- a/drivers/pinctrl/Kconfig
+++ b/drivers/pinctrl/Kconfig
@@ -204,6 +204,13 @@ config PINCTRL_PALMAS
 	  open drain configuration for the Palmas series devices like
 	  TPS65913, TPS80036 etc.
 
+config SENSORS_FP_SPI_GPIO
+	depends on SENSORS_FINGERPRINT
+	string "Fingerprint spi gpio name"
+
+config MST_SECURE_GPIO
+	bool "setting MST gpio as secure pin"
+
 source "drivers/pinctrl/berlin/Kconfig"
 source "drivers/pinctrl/freescale/Kconfig"
 source "drivers/pinctrl/mvebu/Kconfig"
```

## drivers/power/Kconfig.patch
```kconfig
diff --git a/drivers/power/Kconfig b/drivers/power/Kconfig
index 0108c2af005b..4597e8e3b28d 100644
--- a/drivers/power/Kconfig
+++ b/drivers/power/Kconfig
@@ -212,6 +212,17 @@ config BATTERY_MAX17042
 	  with MAX17042. This driver also supports max17047/50 chips which are
 	  improved version of max17042.
 
+config BATTERY_ANDROID
+        tristate "Battery driver for Android"
+        help
+          Say Y to enable generic support for battery charging according
+          to common Android policies.
+          This driver adds periodic battery level and health monitoring,
+          kernel log reporting and other debugging features, common board
+          battery file glue logic for battery/case temperature sensors,
+          etc.
+
+
 config BATTERY_Z2
 	tristate "Z2 battery driver"
 	depends on I2C && MACH_ZIPIT2
@@ -368,6 +379,42 @@ config CHARGER_BQ24735
 	help
 	  Say Y to enable support for the TI BQ24735 battery charger.
 
+config SEC_CHARGER_S2MU003
+	tristate "Samsung S2MU003 charger driver"
+	depends on MFD_S2MU003 && I2C
+	help
+	  Say Y here to enable support for the Samsung S2MU003
+	  battery charger can supoprt PMIC, FLED, Fuel-gauge.
+
+config SEC_FUELGAUGE_S2MU003
+	tristate "Samsung S2MU003 fuel gauge driver"
+	depends on MFD_S2MU003 && I2C
+	help
+	  Say Y here to enable support for the Samsung S2MU003
+	  fuel-gauge driver which can support only voltage-tracking mode.
+
+config SEC_CHARGER_S2MU005
+	tristate "Samsung S2MU005 charger driver"
+	depends on MFD_S2MU005 && I2C
+	help
+	  Say Y here to enable support for the Samsung S2MU005
+	  battery charger can supoprt PMIC, FLED, Fuel-gauge.
+
+config SEC_FUELGAUGE_S2MU005
+	tristate "Samsung S2MU005 fuel gauge driver"
+	depends on MFD_S2MU005 && I2C
+	help
+	  Say Y here to enable support for the Samsung S2MU003
+	  fuel-gauge driver which can support only voltage-tracking mode.
+
+config FUELGAUGE_MAX17058_POWER
+	tristate "MAX17058 fuel gauge driver"
+	default n
+	depends on I2C
+	help
+	 Say Y to include support
+	 for MAXIM MAX17058 fuel gauge driver.
+
 config CHARGER_SMB347
 	tristate "Summit Microelectronics SMB347 Battery Charger"
 	depends on I2C
```

## drivers/pwm/Kconfig.patch
```kconfig
diff --git a/drivers/pwm/Kconfig b/drivers/pwm/Kconfig
index ef2dd2e4754b..7f3bb47181aa 100644
--- a/drivers/pwm/Kconfig
+++ b/drivers/pwm/Kconfig
@@ -235,7 +235,7 @@ config PWM_ROCKCHIP
 
 config PWM_SAMSUNG
 	tristate "Samsung PWM support"
-	depends on PLAT_SAMSUNG
+	depends on ARCH_EXYNOS
 	help
 	  Generic PWM framework driver for Samsung.
 
```

## drivers/regulator/Kconfig.patch
```kconfig
diff --git a/drivers/regulator/Kconfig b/drivers/regulator/Kconfig
index 55d7b7b0f2e0..944d8035aaa5 100644
--- a/drivers/regulator/Kconfig
+++ b/drivers/regulator/Kconfig
@@ -414,6 +414,14 @@ config REGULATOR_MAX77802
 	  Exynos5420/Exynos5800 SoCs to control various voltages.
 	  It includes support for control of voltage and ramp speed.
 
+config REGULATOR_MAX77838
+	tristate "Maxim 77838 regulator"
+	depends on I2C
+	help
+	  This driver controls a Maxim 77838 regulator
+	  via I2C bus. The provided regulator is suitable for
+	  Exynos-7 chips to control DISP & TSP voltages.
+
 config REGULATOR_MC13XXX_CORE
 	tristate
 
@@ -529,13 +537,73 @@ config REGULATOR_S2MPA01
 	 via I2C bus. S2MPA01 has 10 Bucks and 26 LDO outputs.
 
 config REGULATOR_S2MPS11
-	tristate "Samsung S2MPS11/S2MPS14/S2MPU02 voltage regulator"
+	tristate "Samsung S2MPS11 voltage regulator"
+	depends on MFD_SEC_CORE
+	help
+	 This driver supports a Samsung S2MPS11 voltage output regulator
+	 via I2C bus. S2MPS11 is comprised of high efficient Buck converters
+	 including Dual-Phase Buck converter, Buck-Boost converter, various LDOs.
+
+config REGULATOR_S2MPS13
+	tristate "Samsung S2MPS13 voltage regulator"
+	depends on MFD_SEC_CORE
+	help
+	 This driver supports a Samsung S2MPS13 voltage output regulator
+	 via I2C bus. S2MPS13 is comprised of high efficient Buck converters
+	 including Dual-Phase Buck converter, Buck-Boost converter, various LDOs.
+
+config REGULATOR_S2MPS15
+	tristate "Samsung S2MPS15 voltage regulator"
+	depends on MFD_SEC_CORE
+	help
+	 This driver supports a Samsung S2MPS15 voltage output regulator
+	 via I2C bus. S2MPS15 is comprised of high efficient Buck converters
+	 including Dual-Phase Buck converter, Buck-Boost converter, various LDOs.
+
+config REGULATOR_S2MPS16
+	tristate "Samsung S2MPS16 voltage regulator"
+	depends on MFD_SEC_CORE
+	help
+	 This driver supports a Samsung S2MPS16 voltage output regulator
+	 via I2C bus. S2MPS16 is comprised of high efficient Buck converters
+	 including Dual-Phase Buck converter, Buck-Boost converter, various LDOs.
+
+config REGULATOR_S2MPU03
+	tristate "Samsung S2MPU03 voltage regulator"
+	depends on MFD_SEC_CORE
+	help
+	 This driver supports a Samsung S2MPU03 voltage output regulator
+	 via I2C bus. S2MPU03 is comprised of high efficient Buck converters
+	 including Dual-Phase Buck converter, Buck-Boost converter, various LDOs.
+
+config REGULATOR_S2MPU05
+	tristate "Samsung S2MPU05 voltage regulator"
 	depends on MFD_SEC_CORE
 	help
-	 This driver supports a Samsung S2MPS11/S2MPS14/S2MPU02 voltage output
-	 regulator via I2C bus. The chip is comprised of high efficient Buck
-	 converters including Dual-Phase Buck converter, Buck-Boost converter,
-	 various LDOs.
+	 This driver supports a Samsung S2MPU05 voltage output regulator
+	 via I2C bus. S2MPU05 is comprised of high efficient Buck converters
+	 including Dual-Phase Buck converter, Buck-Boost converter, various LDOs.
+
+config REGULATOR_S2MPB01
+	tristate "Samsung S2MPB01 voltage regulator"
+	depends on I2C
+	help
+	 This driver supports a Samsung Sub-PMIC S2MPB01 voltage output regulator
+	 via I2C bus. S2MPB01 is comprised of Buck & LDOs.
+
+config REGULATOR_S2MPB02
+	tristate "Samsung S2MPB02 regulator"
+	depends on MFD_S2MPB02
+	help
+	 This driver controls a Samsung S2MPB02 regulator
+	 via I2C bus.
+
+config REGULATOR_S2MU003
+	tristate "Samsung S2MU003 voltage regulator"
+	depends on MFD_S2MU003
+	help
+	 This driver supports a Samsung Sub-PMIC S2MU003 voltage output regulator
+	 via I2C bus. S2MU003 is comprised of Buck & LDOs.
 
 config REGULATOR_S5M8767
 	tristate "Samsung S5M8767A voltage regulator"
@@ -725,5 +793,14 @@ config REGULATOR_WM8994
 	  This driver provides support for the voltage regulators on the
 	  WM8994 CODEC.
 
+config REGULATOR_SM5703
+	tristate "SM5703 regulator"
+	depends on MFD_SM5703
+	help
+	  This driver controls a SM5703 regulator
+	  via I2C bus. The provided regulator is suitable for
+	  Exynos-5 chips to control VCC_CORE and
+	  VCC_USIM voltages.
+
 endif
 
```
