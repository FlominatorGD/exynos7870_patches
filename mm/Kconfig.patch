## mm/Kconfig.patch
```kconfig
diff --git a/mm/Kconfig b/mm/Kconfig
index 95c5728d65bc..c8db71b6c633 100644
--- a/mm/Kconfig
+++ b/mm/Kconfig
@@ -259,6 +259,12 @@ config COMPACTION
 	depends on MMU
 	help
 	  Allows the compaction of memory for the allocation of huge pages.
+config SEC_PHCOMP
+	bool "Allow for Predictive Hidden Compaction"
+	def_bool n
+	depends on COMPACTION
+	help
+	  do compaction during cpu c2 state
 
 #
 # support for page migration
@@ -516,6 +522,13 @@ config CMA_DEBUG
 	  processing calls such as dma_alloc_from_contiguous().
 	  This option does not affect warning and error messages.
 
+config CMA_PINPAGE_MIGRATION
+	bool "CMA pinned page migration (EXPERIMENTAL)"
+	depends on CMA
+	default n
+	help
+	  Turns on cma page migration for pinned page.
+
 config CMA_AREAS
 	int "Maximum count of the CMA areas"
 	depends on CMA
@@ -542,7 +555,7 @@ config MEM_SOFT_DIRTY
 config ZSWAP
 	bool "Compressed cache for swap pages (EXPERIMENTAL)"
 	depends on FRONTSWAP && CRYPTO=y
-	select CRYPTO_LZO
+	select CRYPTO_LZ4
 	select ZPOOL
 	default n
 	help
@@ -559,6 +572,24 @@ config ZSWAP
 	  they have not be fully explored on the large set of potential
 	  configurations and workloads that exist.
 
+config ZSWAP_ENABLE_WRITEBACK
+	bool "Enable zswap writeback"
+	depends on ZSWAP
+	default n
+
+config ZSWAP_SAME_PAGE_SHARING
+	bool "Enable same page sharing support in zswap"
+	depends on ZSWAP && !ZSWAP_ENABLE_WRITEBACK
+	default n
+	help
+	  This option adds a feature to share the compressed pages
+	  written to zswap if the pages are found to be same.
+
+config ZSWAP_COMPACTION
+	bool "Enable runtime zswap compaction"
+	depends on ZSWAP && ZPOOL && ZSMALLOC
+	default n
+
 config ZPOOL
 	tristate "Common API for compressed memory storage"
 	default n
@@ -611,6 +642,45 @@ config ZSMALLOC_STAT
 	  information to userspace via debugfs.
 	  If unsure, say N.
 
+config ZSMALLOC_OBJ_SEQ
+	bool "Record the sequence number of each object in itself"
+	depends on ZSMALLOC
+	default n
+	help
+	  This option records the sequence number of each zs object in the object.
+	  The recorded number will be used for reclaim_zspage.
+	  If unsure, say N.
+
+config DIRECT_RECLAIM_FILE_PAGES_ONLY
+	bool "Reclaim file pages only on direct reclaim path"
+	depends on ZSWAP
+	default n
+
+config INCREASE_MAXIMUM_SWAPPINESS
+	bool "Allow swappiness to be set up to 200"
+	depends on ZSWAP
+	default n
+
+config FIX_INACTIVE_RATIO
+	bool "Fix active:inactive anon ratio to 1:1"
+	depends on ZSWAP
+	default n
+
+config TIGHT_PGDAT_BALANCE
+	bool "Set more tight balanced condition to kswapd"
+	depends on ZSWAP
+	default n
+
+config SWAP_ENABLE_READAHEAD
+	bool "Enable readahead on page swap in"
+	depends on SWAP
+	default y
+	help
+	  When a page fault occurs, adjacent pages of SWAP_CLUSTER_MAX are
+	  also paged in expecting those pages will be used in near future.
+	  This behaviour is good at disk-based system, but not on in-memory
+	  compression (e.g. zram).
+
 config GENERIC_EARLY_IOREMAP
 	bool
 
@@ -628,3 +698,48 @@ config MAX_STACK_SIZE_MB
 	  changed to a smaller value in which case that is used.
 
 	  A sane initial value is 80 MB.
+
+config MMAP_READAROUND_LIMIT
+	int "Limit mmap readaround upperbound"
+	default 0
+	help
+	  Inappropriate mmap readaround size can hurt device performance
+	  during the sluggish situation. Add the hard upper-limit for
+	  mmap readaround.
+
+config BALANCE_ANON_FILE_RECLAIM
+	bool "During reclaim treat anon and file backed pages equally"
+	depends on SWAP
+	help
+	  When performing memory reclaim treat anonymous and file backed pages
+	  equally.
+	  Swapping anonymous pages out to memory can be efficient enough to justify
+	  treating anonymous and file backed pages equally.
+
+config VMPRESSURE_LEVEL_MED
+	int "Threshold to account memory pressure"
+	default 60
+	help
+	  This supports to adjust vmpressure_level_med threshold value
+
+config LARGE_DIRTY_BUFFER
+    bool "Use large dirty_threshold value by enabling dirty_ratio"
+    default n
+    help
+     This config enables dirty_ratio/dirty_background_ratio,
+     and it means large dirty_threshold value in 64bit architectures.
+     If unsure, say N to use kernel default value
+
+config MAX_DIRTY_THRESH_PAGES
+   int "The upper bound of VM dirty_thresh value in number of pages"
+   default 0
+   help
+    This value is the upper bound of VM dirty-thresh. (0 means no limit.)
+    It is only effective when dirty_ratio is used.
+    (Setting dirty_bytes disables this option.)
+
+config FAULT_AROUND_4KB
+	bool "Fault around bytes 4KB"
+	default n
+	help
+	  Reduce fault around bytes to 4KB for android GO models.
```

## net/Kconfig.patch
```kconfig
diff --git a/net/Kconfig b/net/Kconfig
index 9cc19bc22dda..ca33382a5042 100644
--- a/net/Kconfig
+++ b/net/Kconfig
@@ -242,6 +242,7 @@ source "net/vmw_vsock/Kconfig"
 source "net/netlink/Kconfig"
 source "net/mpls/Kconfig"
 source "net/hsr/Kconfig"
+source "net/ncm/Kconfig"
 
 config RPS
 	boolean "RPS"
@@ -390,3 +391,9 @@ endif   # if NET
 # Used by archs to tell that they support BPF_JIT
 config HAVE_BPF_JIT
 	bool
+
+# Network Pacemaker
+config NETPM
+	bool "Network Pacemaker"
+	---help---
+	This feature implements Network Pacemaker (NETPM)
```

## net/netfilter/Kconfig.patch
```kconfig
diff --git a/net/netfilter/Kconfig b/net/netfilter/Kconfig
index cd5511ada239..2996afe8a7e5 100644
--- a/net/netfilter/Kconfig
+++ b/net/netfilter/Kconfig
@@ -19,7 +19,7 @@ config NETFILTER_NETLINK_QUEUE
 	help
 	  If this option is enabled, the kernel will include support
 	  for queueing packets via NFNETLINK.
-	  
+
 config NETFILTER_NETLINK_LOG
 	tristate "Netfilter LOG over NFNETLINK interface"
 	default m if NETFILTER_ADVANCED=n
@@ -1306,6 +1306,10 @@ config NETFILTER_XT_MATCH_QTAGUID
 
 	  If unsure, say `N'.
 
+config NETFILTER_XT_MATCH_ONESHOT
+	bool "Support NETFILTER_XT_MATCH_ONESHOT"
+	default n
+
 config NETFILTER_XT_MATCH_QUOTA
 	tristate '"quota" match support'
 	depends on NETFILTER_ADVANCED
@@ -1339,6 +1343,12 @@ config NETFILTER_XT_MATCH_QUOTA2_LOG
 
 	  If unsure, say `N'.
 
+config NETFILTER_XT_MATCH_QUOTA2_LOG_32BIT
+	bool '"quota2" Netfilter LOG support'
+	default n
+	help
+	  Enabel to support an old 32-bit Android platform with 64-bit Kernel.
+
 config NETFILTER_XT_MATCH_RATEEST
 	tristate '"rateest" match support'
 	depends on NETFILTER_ADVANCED
@@ -1357,7 +1367,7 @@ config NETFILTER_XT_MATCH_REALM
 	  This option adds a `realm' match, which allows you to use the realm
 	  key from the routing subsystem inside iptables.
 
-	  This match pretty much resembles the CONFIG_NET_CLS_ROUTE4 option 
+	  This match pretty much resembles the CONFIG_NET_CLS_ROUTE4 option
 	  in tc world.
 
 	  If you want to compile it as a module, say M here and read
@@ -1378,7 +1388,7 @@ config NETFILTER_XT_MATCH_SCTP
 	depends on NETFILTER_ADVANCED
 	default IP_SCTP
 	help
-	  With this option enabled, you will be able to use the 
+	  With this option enabled, you will be able to use the
 	  `sctp' match in order to match on SCTP source/destination ports
 	  and SCTP chunk types.
 
@@ -1473,8 +1483,15 @@ config NETFILTER_XT_MATCH_U32
 
 endif # NETFILTER_XTABLES
 
+config NF_HISTORY
+	bool "Support NF HISTORY"
+	default n
+
 endmenu
 
 source "net/netfilter/ipset/Kconfig"
 
 source "net/netfilter/ipvs/Kconfig"
+
+# interceptor
+source "net/netfilter/interceptor/Kconfig"
```

## net/wireless/Kconfig.patch
```kconfig
diff --git a/net/wireless/Kconfig b/net/wireless/Kconfig
index 29c8675f9a11..86081cc1aa52 100644
--- a/net/wireless/Kconfig
+++ b/net/wireless/Kconfig
@@ -1,5 +1,5 @@
 config WIRELESS_EXT
-	bool
+	def_bool y
 
 config WEXT_CORE
 	def_bool y
@@ -14,7 +14,7 @@ config WEXT_SPY
 	bool
 
 config WEXT_PRIV
-	bool
+	def_bool y
 
 config CFG80211
 	tristate "cfg80211 - wireless configuration API"
@@ -178,10 +178,37 @@ config CFG80211_WEXT
 	bool "cfg80211 wireless extensions compatibility"
 	depends on CFG80211
 	select WEXT_CORE
+	default y
 	help
 	  Enable this option if you need old userspace for wireless
 	  extensions with cfg80211-based drivers.
 
+config CONFIG_WLAN_SEC_REGULATORY_POLICY
+	bool "whether to use the db.txt_old or not"
+    	default n 
+	  
+config WIRELESS_EXT_SYSFS
+	bool "Wireless extensions sysfs files"
+	depends on WEXT_CORE && SYSFS
+	help
+	  This option enables the deprecated wireless statistics
+	  files in /sys/class/net/*/wireless/. The same information
+	  is available via the ioctls as well.
+
+	  Say N. If you know you have ancient tools requiring it,
+	  like very old versions of hal (prior to 0.5.12 release),
+	  say Y and update the tools as soon as possible as this
+	  option will be removed soon.
+
+config CFG80211_REG_NOT_UPDATED
+	bool "Do not update Regulatory configuration"
+	depends on CFG80211
+	default n
+	help
+	  Regulation should not updated even if device found other country
+	  Access Point Beacon once since device should find around other
+	  Access Points.
+
 config LIB80211
 	tristate
 	default n
@@ -209,3 +236,23 @@ config LIB80211_DEBUG
 	  from lib80211.
 
 	  If unsure, say N.
+
+config CFG80211_ALLOW_RECONNECT
+	bool "Allow reconnect while already connected"
+	depends on CFG80211
+	default n
+	help
+	  cfg80211 stack doesn't allow to connect if you are already
+	  connected. This option allows to make a connection in this case.
+
+	  Select this option ONLY for wlan drivers that are specifically
+	  built for such purposes.
+
+config CFG80211_REG_NOT_UPDATED
+	bool "Do not update Regulatory configuration"
+	depends on CFG80211
+	default n
+	help
+	  Regulation should not updated even if device found other country
+	  Access Point Beacon once since device should find around other
+	  Access Points.
\ No newline at end of file
```

## security/Kconfig.patch
```kconfig
diff --git a/security/Kconfig b/security/Kconfig
index 601882ce946a..a81ec32facbc 100644
--- a/security/Kconfig
+++ b/security/Kconfig
@@ -171,8 +171,13 @@ source security/smack/Kconfig
 source security/tomoyo/Kconfig
 source security/apparmor/Kconfig
 source security/yama/Kconfig
-
+source security/mstdrv/Kconfig
 source security/integrity/Kconfig
+source security/tz_iccc/Kconfig
+source security/samsung/five/Kconfig
+source security/samsung/defex_lsm/Kconfig
+source security/proca/Kconfig
+source security/samsung/dsms/Kconfig
 
 choice
 	prompt "Default security module"
```

## security/selinux/Kconfig.patch
```kconfig
diff --git a/security/selinux/Kconfig b/security/selinux/Kconfig
index bca1b74a4a2f..b4ff3013a69c 100644
--- a/security/selinux/Kconfig
+++ b/security/selinux/Kconfig
@@ -64,6 +64,27 @@ config SECURITY_SELINUX_DEVELOP
 	  unless you specify enforcing=1 on the kernel command line.  You
 	  can interactively toggle the kernel between enforcing mode and
 	  permissive mode (if permitted by the policy) via /selinux/enforce.
+	  
+config SECURITY_SELINUX_FAKE_ENFORCE
+	bool "NSA SELinux Fake Enforcing"
+	depends on SECURITY_SELINUX_DEVELOP
+	default n
+	help
+	  This option will set SELinux to permissive with fake enforcing status.
+
+config SECURITY_SELINUX_ALWAYS_ENFORCE
+	bool "NSA SELinux Always Enforcing"
+	depends on SECURITY_SELINUX_DEVELOP
+	default n
+	help
+	  This option will prevent anything from setting SELinux to permissive.
+
+config SECURITY_SELINUX_NEVER_ENFORCE
+	bool "NSA SELinux Never Enforcing"
+	depends on SECURITY_SELINUX_DEVELOP
+	default n
+	help
+	  This option will prevent anything from setting SELinux to enforcing.	  
 
 config SECURITY_SELINUX_AVC_STATS
 	bool "NSA SELinux AVC Statistics"
```

## sound/soc/codecs/Kconfig.patch
```kconfig
diff --git a/sound/soc/codecs/Kconfig b/sound/soc/codecs/Kconfig
index a68d1731a8fd..90c41e7a1932 100644
--- a/sound/soc/codecs/Kconfig
+++ b/sound/soc/codecs/Kconfig
@@ -44,6 +44,8 @@ config SND_SOC_ALL_CODECS
 	select SND_SOC_ALC5632 if I2C
 	select SND_SOC_CQ0093VC if MFD_DAVINCI_VOICECODEC
 	select SND_SOC_CS35L32 if I2C
+	select SND_SOC_CS35L40_I2C if I2C
+	select SND_SOC_CS35L40_SPI if SPI_MASTER
 	select SND_SOC_CS42L51_I2C if I2C
 	select SND_SOC_CS42L52 if I2C && INPUT
 	select SND_SOC_CS42L56 if I2C && INPUT
@@ -86,6 +88,7 @@ config SND_SOC_ALL_CODECS
 	select SND_SOC_RT5651 if I2C
 	select SND_SOC_RT5670 if I2C
 	select SND_SOC_RT5677 if I2C
+	select SND_SOC_RT5659 if I2C
 	select SND_SOC_SGTL5000 if I2C
 	select SND_SOC_SI476X if MFD_SI476X_CORE
 	select SND_SOC_SIRF_AUDIO_CODEC
@@ -200,6 +203,7 @@ config SND_SOC_WM_ADSP
 	default m if SND_SOC_WM5102=m
 	default m if SND_SOC_WM5110=m
 	default m if SND_SOC_WM2200=m
+	default y if SND_SOC_CS35L40=y
 
 config SND_SOC_AB8500_CODEC
 	tristate
@@ -332,6 +336,10 @@ config SND_SOC_CS35L32
 	tristate "Cirrus Logic CS35L32 CODEC"
 	depends on I2C
 
+config SND_SOC_CS35L40
+	tristate "Cirrus Logic CS35L40 CODEC"
+	select SND_SOC_WM_ADSP
+
 config SND_SOC_CS42L51
 	tristate
 
@@ -386,6 +394,9 @@ config SND_SOC_CX20442
 	tristate
 	depends on TTY
 
+config SND_SOC_COD3026X
+	tristate
+
 config SND_SOC_JZ4740_CODEC
 	select REGMAP_MMIO
 	tristate
@@ -504,6 +515,9 @@ config SND_SOC_RT5670
 config SND_SOC_RT5677
 	tristate
 
+config SND_SOC_RT5659
+	tristate
+
 #Freescale sgtl5000 codec
 config SND_SOC_SGTL5000
 	tristate "Freescale SGTL5000 CODEC"
@@ -534,6 +548,21 @@ config SND_SOC_SN95031
 config SND_SOC_SPDIF
 	tristate "S/PDIF CODEC"
 
+config SND_SOC_EXYNOS_AUDMIXER
+        tristate
+        select REGMAP_MMIO
+        select REGMAP_I2C
+
+config SND_SOC_EXYNOS_AUDMIXER_VER
+	int "Driver version of Exynos Audio Mixer"
+	range 1 2
+	default 2 if SND_SOC_SAMSUNG_UNIVERSAL7870_COD3026X
+	default 1
+	depends on SND_SOC_EXYNOS_AUDMIXER
+	help
+	  Set version 1 for legacy driver
+	  Set version 2 for independent ASoC compliant driver
+
 config SND_SOC_SSM2518
 	tristate
 
@@ -789,6 +818,15 @@ config SND_SOC_WM9712
 config SND_SOC_WM9713
 	tristate
 
+config SND_SOC_DUMMY_CODEC
+	tristate
+
+config SND_SOC_COD30XX_EXT_ANT
+	bool "ISDB-T External antenna"
+	default n
+	help
+	  Support for ISDB-T External antenna.
+
 # Amp
 config SND_SOC_LM4857
 	tristate
@@ -809,4 +847,13 @@ config SND_SOC_TPA6130A2
 	tristate "Texas Instruments TPA6130A2 headphone amplifier"
 	depends on I2C
 
+config SND_SOC_TFA_LOG_USER_HOST
+	tristate
+
+config SND_SOC_TFA9896
+	tristate "Support TFA9896"
+	default n
+	help
+	TFA9896 driver
+
 endmenu
```
