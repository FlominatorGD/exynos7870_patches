## crypto/Kconfig.patch
```kconfig
diff --git a/crypto/Kconfig b/crypto/Kconfig
index 8bdd83493d7d..dc982fb0da08 100644
--- a/crypto/Kconfig
+++ b/crypto/Kconfig
@@ -24,7 +24,6 @@ comment "Crypto core or helper"
 config CRYPTO_FIPS
 	bool "FIPS 200 compliance"
 	depends on (CRYPTO_ANSI_CPRNG || CRYPTO_DRBG) && !CRYPTO_MANAGER_DISABLE_TESTS
-	depends on MODULE_SIG
 	help
 	  This options enables the fips boot option which is
 	  required if you want to system to operate in a FIPS 200
@@ -184,7 +183,7 @@ config CRYPTO_AUTHENC
 
 config CRYPTO_TEST
 	tristate "Testing module"
-	depends on m
+	default n
 	select CRYPTO_MANAGER
 	help
 	  Quick & dirty crypto test module.
@@ -1467,7 +1466,7 @@ comment "Random Number Generation"
 
 config CRYPTO_ANSI_CPRNG
 	tristate "Pseudo Random Number Generation for Cryptographic modules"
-	default m
+	default n
 	select CRYPTO_AES
 	select CRYPTO_RNG
 	help
@@ -1534,6 +1533,18 @@ config CRYPTO_USER_API_SKCIPHER
 config CRYPTO_HASH_INFO
 	bool
 
+config CRYPTO_POST_DEFERRED_INIT
+	bool "FIPS POST via deferred_module_init"
+	default n
+
+config CRYPTO_POST_LATE_INIT_SYNC
+	bool "FIPS POST via late_initcall_sync"
+	default n
+
+config CRYPTO_POST_LATE_INIT
+	bool "FIPS POST via late_initcall"
+	default n
+
 source "drivers/crypto/Kconfig"
 source crypto/asymmetric_keys/Kconfig
 
```

## drivers/Kconfig.patch
```kconfig
diff --git a/drivers/Kconfig b/drivers/Kconfig
index e451dbab0964..ffdefec87112 100644
--- a/drivers/Kconfig
+++ b/drivers/Kconfig
@@ -20,6 +20,12 @@ source "drivers/block/Kconfig"
 
 source "drivers/misc/Kconfig"
 
+source "drivers/staging/samsung/sec_notifier/Kconfig"
+
+source "drivers/muic/Kconfig"
+
+source "drivers/ifpmic/Kconfig"
+
 source "drivers/ide/Kconfig"
 
 source "drivers/scsi/Kconfig"
@@ -150,8 +156,6 @@ source "drivers/remoteproc/Kconfig"
 
 source "drivers/rpmsg/Kconfig"
 
-source "drivers/soc/Kconfig"
-
 source "drivers/devfreq/Kconfig"
 
 source "drivers/extcon/Kconfig"
@@ -170,6 +174,10 @@ source "drivers/irqchip/Kconfig"
 
 source "drivers/ipack/Kconfig"
 
+source "drivers/battery/Kconfig"
+
+source "drivers/battery_v2/Kconfig"
+
 source "drivers/reset/Kconfig"
 
 source "drivers/fmc/Kconfig"
@@ -184,4 +192,30 @@ source "drivers/ras/Kconfig"
 
 source "drivers/thunderbolt/Kconfig"
 
+source "drivers/trace/Kconfig"
+
+source "drivers/ccic/Kconfig"
+
+source "drivers/bts/Kconfig"
+
+source "drivers/gud/Kconfig"
+
+source "drivers/mailbox/samsung/Kconfig"
+
+source "drivers/marvell/Kconfig"
+
+source "drivers/sensors/Kconfig"
+
+source "drivers/motor/Kconfig"
+
+source "drivers/fingerprint/Kconfig"
+
+source "drivers/gps/Kconfig"
+
+source "drivers/sensorhub/Kconfig"
+
+source "drivers/five/Kconfig"
+
+source "drivers/security/samsung/icdrv/Kconfig"
+
 endmenu
```

## drivers/block/zram/Kconfig.patch
```kconfig
diff --git a/drivers/block/zram/Kconfig b/drivers/block/zram/Kconfig
index 6489c0fd0ea6..3e174112869c 100644
--- a/drivers/block/zram/Kconfig
+++ b/drivers/block/zram/Kconfig
@@ -1,9 +1,9 @@
 config ZRAM
 	tristate "Compressed RAM block device support"
 	depends on BLOCK && SYSFS && ZSMALLOC
-	select LZO_COMPRESS
-	select LZO_DECOMPRESS
-	default n
+	select LZ4_COMPRESS
+	select LZ4_DECOMPRESS
+	default y
 	help
 	  Creates virtual block devices called /dev/zramX (X = 0, 1, ...).
 	  Pages written to these disks are compressed and stored in memory
```

## drivers/char/hw_random/Kconfig.patch
```kconfig
diff --git a/drivers/char/hw_random/Kconfig b/drivers/char/hw_random/Kconfig
index 91a04ae8003c..2a4bc90ab9fb 100644
--- a/drivers/char/hw_random/Kconfig
+++ b/drivers/char/hw_random/Kconfig
@@ -307,6 +307,43 @@ config HW_RANDOM_EXYNOS
 
 	  If unsure, say Y.
 
+config HW_RANDOM_EXYNOS_SWD
+	tristate "EXYNOS SWD HW random number generator support"
+	depends on ARCH_EXYNOS
+	default HW_RANDOM
+	---help---
+	  This driver provides kernel-side support for TRNG hardware
+	  found in secure world by using smc call
+
+	  To compile this driver as a module, choose M here: the
+	  module will be called exynos-rng.
+
+	  If unsure, say Y.
+
+config EXYRNG_FIPS_COMPLIANCE
+	bool "Compliant with FIPS 140-2"
+	depends on HW_RANDOM_EXYNOS_SWD
+
+choice
+	prompt "Fail Policy"
+	depends on EXYRNG_FIPS_COMPLIANCE
+	default EXYRNG_FAIL_POLICY_DISABLE
+
+config EXYRNG_FAIL_POLICY_DISABLE
+	bool "Disable RNG if the tests fail"
+	depends on EXYRNG_FIPS_COMPLIANCE
+
+config EXYRNG_FAIL_POLICY_RESET
+	bool "Reset if the tests fail"
+	depends on EXYRNG_FIPS_COMPLIANCE
+
+endchoice
+
+config EXYRNG_USE_CRYPTOMANAGER
+	tristate "Use CryptoManager"
+	depends on HW_RANDOM_EXYNOS_SWD
+	default n
+
 config HW_RANDOM_TPM
 	tristate "TPM HW Random Number Generator support"
 	depends on TCG_TPM
@@ -362,3 +399,4 @@ config UML_RANDOM
 	  (check your distro, or download from
 	  http://sourceforge.net/projects/gkernel/).  rngd periodically reads
 	  /dev/hwrng and injects the entropy into /dev/random.
+
```

## drivers/clocksource/Kconfig.patch
```kconfig
diff --git a/drivers/clocksource/Kconfig b/drivers/clocksource/Kconfig
index 2a6b2a8e1578..09f3b434a8f4 100644
--- a/drivers/clocksource/Kconfig
+++ b/drivers/clocksource/Kconfig
@@ -142,7 +142,6 @@ config CLKSRC_METAG_GENERIC
 
 config CLKSRC_EXYNOS_MCT
 	def_bool y if ARCH_EXYNOS
-	depends on !ARM64
 	help
 	  Support for Multi Core Timer controller on Exynos SoCs.
 
```

## drivers/cpufreq/Kconfig.arm.patch
```kconfig
diff --git a/drivers/cpufreq/Kconfig.arm b/drivers/cpufreq/Kconfig.arm
index 83a75dc84761..0b56ee383374 100644
--- a/drivers/cpufreq/Kconfig.arm
+++ b/drivers/cpufreq/Kconfig.arm
@@ -39,6 +39,15 @@ config ARM_EXYNOS4210_CPUFREQ
 
 	  If in doubt, say N.
 
+config ARM_EXYNOS_MP_CPUFREQ
+	bool "SAMSUNG EXYNOS SoCs for MP"
+	depends on ARCH_EXYNOS
+	help
+	  This adds the MP CPUFreq driver common part for Samsung
+	  EXYNOS SoCs.
+
+	  If in doubt, say N.
+
 config ARM_EXYNOS4X12_CPUFREQ
 	bool "SAMSUNG EXYNOS4x12"
 	depends on SOC_EXYNOS4212 || SOC_EXYNOS4412
```

## drivers/cpufreq/Kconfig.patch
```kconfig
diff --git a/drivers/cpufreq/Kconfig b/drivers/cpufreq/Kconfig
index a9fdec8597f7..047ac5b3d966 100644
--- a/drivers/cpufreq/Kconfig
+++ b/drivers/cpufreq/Kconfig
@@ -45,6 +45,12 @@ config CPU_FREQ_STAT_DETAILS
 
 	  If in doubt, say N.
 
+config LOAD_BASED_CORE_CURRENT_CAL
+	bool "CPU current accuracy improvement"
+	default n
+	help
+	  This option enable core current calculation to include core work load for Exynos7870
+
 choice
 	prompt "Default CPUFreq governor"
 	default CPU_FREQ_DEFAULT_GOV_USERSPACE if ARM_SA1100_CPUFREQ || ARM_SA1110_CPUFREQ
```

## drivers/cpuidle/Kconfig.patch
```kconfig
diff --git a/drivers/cpuidle/Kconfig b/drivers/cpuidle/Kconfig
index c5029c1209b4..e5ba580ca65b 100644
--- a/drivers/cpuidle/Kconfig
+++ b/drivers/cpuidle/Kconfig
@@ -28,6 +28,10 @@ config CPU_IDLE_GOV_MENU
 config DT_IDLE_STATES
 	bool
 
+config CPU_IDLE_STOP_IDLE_DURING_HOTPLUG
+	bool "Stop idle during hotplug in/out"
+	depends on CPU_IDLE && HOTPLUG_CPU
+
 menu "ARM CPU Idle Drivers"
 depends on ARM
 source "drivers/cpuidle/Kconfig.arm"
```

## drivers/devfreq/Kconfig.patch
```kconfig
diff --git a/drivers/devfreq/Kconfig b/drivers/devfreq/Kconfig
index faf4e70c42e0..f3baeb98506c 100644
--- a/drivers/devfreq/Kconfig
+++ b/drivers/devfreq/Kconfig
@@ -38,6 +38,16 @@ config DEVFREQ_GOV_SIMPLE_ONDEMAND
 	  values that imply the usage rate. A device may provide tuned
 	  values to the governor with data field at devfreq_add_device().
 
+config DEVFREQ_GOV_SIMPLE_USAGE
+	tristate "Simple Usage"
+	help
+	  Chooses frequency based on the percentage of target device.
+
+config DEVFREQ_GOV_SIMPLE_EXYNOS
+	tristate "Simple Exynos"
+	help
+	  Chooses frequency based on the threshold of target device.
+
 config DEVFREQ_GOV_PERFORMANCE
 	tristate "Performance"
 	help
@@ -65,6 +75,18 @@ config DEVFREQ_GOV_USERSPACE
 
 comment "DEVFREQ Drivers"
 
+config ARM_EXYNOS_DEVFREQ
+	bool "ARM Exynos Memory Bus DEVFREQ Common driver"
+	depends on ARCH_EXYNOS
+	select ARCH_HAS_OPP
+	select PM_OPP
+	help
+	  This adds the DEVFREQ driver for Exynos series common bus.
+
+config ARM_EXYNOS_DEVFREQ_DEBUG
+	bool "ARM Exynos DEVFREQ sysfs for Debug"
+	depends on ARM_EXYNOS_DEVFREQ
+
 config ARM_EXYNOS4_BUS_DEVFREQ
 	bool "ARM Exynos4210/4212/4412 Memory Bus DEVFREQ Driver"
 	depends on (CPU_EXYNOS4210 || SOC_EXYNOS4212 || SOC_EXYNOS4412) && !ARCH_MULTIPLATFORM
@@ -87,4 +109,24 @@ config ARM_EXYNOS5_BUS_DEVFREQ
 	  It reads PPMU counters of memory controllers and adjusts the
 	  operating frequencies and voltages with OPP support.
 
+config ARM_EXYNOS8890_BUS_DEVFREQ
+	bool "ARM Exynos8890 Memory Bus DEVFREQ Driver"
+	default y
+	depends on ARM_EXYNOS_DEVFREQ
+	depends on SOC_EXYNOS8890
+	select DEVFREQ_GOV_SIMPLE_ONDEMAND
+	select DEVFREQ_GOV_SIMPLE_EXYNOS
+	help
+	  This adds the DEVFREQ driver for Exynos8890 memory and int.
+
+config ARM_EXYNOS7870_BUS_DEVFREQ
+	bool "ARM Exynos7870 Memory Bus DEVFREQ Driver"
+	default y
+	depends on ARM_EXYNOS_DEVFREQ
+	depends on SOC_EXYNOS7870
+	select DEVFREQ_GOV_SIMPLE_ONDEMAND
+	select DEVFREQ_GOV_SIMPLE_EXYNOS
+	help
+	  This adds the DEVFREQ driver for Exynos7870 memory and int.
+
 endif # PM_DEVFREQ
```
